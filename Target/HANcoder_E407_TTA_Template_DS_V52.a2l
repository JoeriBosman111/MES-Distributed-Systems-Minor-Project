/******************************************************************************
* ASAP2 file: HANcoder_E407_TTA_Template_DS_V52.a2l
* Academic License - for use in teaching, academic research, and meeting
* course requirements at degree granting institutions only. Not for
* government, commercial, or other organizational use.
* Code generation for model "HANcoder_E407_TTA_Template_DS_V52".
* Model version : 10.39
* Simulink Coder version : 9.9 (R2023a) 19-Nov-2022
* C source code generated on : Mon Jun 12 15:04:18 2023
* Target selection: ert.tlc
* Embedded hardware selection: ARM Compatible->ARM Cortex
* Code generation objectives: Unspecified
* Validation result: Not run
* (add additional file header information here)
******************************************************************************/ ASAP2_VERSION 1 31
/* Version 1.31 */
/begin PROJECT ProjectName "HANcoder_E407_TTA_Template_DS_V52_softwareID_v1_120623_150156"
/begin HEADER "Header Comments go here" /end HEADER
/begin MODULE ModuleName "Module Comment Goes Here"
/begin MOD_PAR "MOD PAR Comment Goes Here" ADDR_EPK 0x0800c5a4 CPU_TYPE "STM32F407" ECU "E407" EPK "HANcoder_E407_TTA_Template_DS_V52_softwareID_v1_120623_150156"
 SYSTEM_CONSTANT "XcpStationID string length" "0x0000003d"
 SYSTEM_CONSTANT "RAM-FlashOffset" "-402494624" /end MOD_PAR
/begin MOD_COMMON "Mod Common Comment Here" BYTE_ORDER MSB_LAST /end MOD_COMMON
/begin RECORD_LAYOUT Scalar_BOOLEAN FNC_VALUES 1 UBYTE COLUMN_DIR DIRECT /end RECORD_LAYOUT
/begin RECORD_LAYOUT Scalar_UBYTE FNC_VALUES 1 UBYTE COLUMN_DIR DIRECT /end RECORD_LAYOUT
/begin RECORD_LAYOUT Scalar_BYTE FNC_VALUES 1 SBYTE COLUMN_DIR DIRECT /end RECORD_LAYOUT
/begin RECORD_LAYOUT Scalar_UWORD FNC_VALUES 1 UWORD COLUMN_DIR DIRECT /end RECORD_LAYOUT
/begin RECORD_LAYOUT Scalar_SWORD FNC_VALUES 1 SWORD COLUMN_DIR DIRECT /end RECORD_LAYOUT
/begin RECORD_LAYOUT Scalar_ULONG FNC_VALUES 1 ULONG COLUMN_DIR DIRECT /end RECORD_LAYOUT
/begin RECORD_LAYOUT Scalar_LONG FNC_VALUES 1 SLONG COLUMN_DIR DIRECT /end RECORD_LAYOUT
/begin RECORD_LAYOUT Scalar_FLOAT32_IEEE FNC_VALUES 1 FLOAT32_IEEE COLUMN_DIR DIRECT /end RECORD_LAYOUT
/begin RECORD_LAYOUT Scalar_FLOAT64_IEEE FNC_VALUES 1 FLOAT64_IEEE COLUMN_DIR DIRECT /end RECORD_LAYOUT
/begin RECORD_LAYOUT Lookup1D_BYTE FNC_VALUES 1 SBYTE COLUMN_DIR DIRECT /end RECORD_LAYOUT
/begin RECORD_LAYOUT Lookup1D_X_BYTE AXIS_PTS_X 1 SBYTE INDEX_INCR DIRECT /end RECORD_LAYOUT
/begin RECORD_LAYOUT Lookup1D_UBYTE FNC_VALUES 1 UBYTE COLUMN_DIR DIRECT /end RECORD_LAYOUT
/begin RECORD_LAYOUT Lookup1D_X_UBYTE AXIS_PTS_X 1 UBYTE INDEX_INCR DIRECT /end RECORD_LAYOUT
/begin RECORD_LAYOUT Lookup1D_UWORD FNC_VALUES 1 UWORD COLUMN_DIR DIRECT /end RECORD_LAYOUT
/begin RECORD_LAYOUT Lookup1D_X_UWORD AXIS_PTS_X 1 UWORD INDEX_INCR DIRECT /end RECORD_LAYOUT
/begin RECORD_LAYOUT Lookup1D_WORD FNC_VALUES 1 SWORD COLUMN_DIR DIRECT /end RECORD_LAYOUT
/begin RECORD_LAYOUT Lookup1D_X_WORD AXIS_PTS_X 1 SWORD INDEX_INCR DIRECT /end RECORD_LAYOUT
/begin RECORD_LAYOUT Lookup1D_ULONG FNC_VALUES 1 ULONG COLUMN_DIR DIRECT /end RECORD_LAYOUT
/begin RECORD_LAYOUT Lookup1D_X_ULONG AXIS_PTS_X 1 ULONG INDEX_INCR DIRECT /end RECORD_LAYOUT
/begin RECORD_LAYOUT Lookup1D_SLONG FNC_VALUES 1 SLONG COLUMN_DIR DIRECT /end RECORD_LAYOUT
/begin RECORD_LAYOUT Lookup1D_X_LONG AXIS_PTS_X 1 SLONG INDEX_INCR DIRECT /end RECORD_LAYOUT
/begin RECORD_LAYOUT Lookup1D_FLOAT32_IEEE FNC_VALUES 1 FLOAT32_IEEE COLUMN_DIR DIRECT /end RECORD_LAYOUT
/begin RECORD_LAYOUT Lookup1D_X_FLOAT32_IEEE AXIS_PTS_X 1 FLOAT32_IEEE INDEX_INCR DIRECT /end RECORD_LAYOUT
/begin RECORD_LAYOUT Lookup1D_FLOAT64_IEEE FNC_VALUES 1 FLOAT64_IEEE COLUMN_DIR DIRECT /end RECORD_LAYOUT
/begin RECORD_LAYOUT Lookup1D_X_FLOAT64_IEEE AXIS_PTS_X 1 FLOAT64_IEEE INDEX_INCR DIRECT /end RECORD_LAYOUT
/begin RECORD_LAYOUT Lookup2D_UBYTE FNC_VALUES 1 UBYTE COLUMN_DIR DIRECT /end RECORD_LAYOUT
/begin RECORD_LAYOUT Lookup2D_X_UBYTE AXIS_PTS_X 1 UBYTE INDEX_INCR DIRECT /end RECORD_LAYOUT
/begin RECORD_LAYOUT Lookup2D_BYTE FNC_VALUES 1 SBYTE COLUMN_DIR DIRECT /end RECORD_LAYOUT
/begin RECORD_LAYOUT Lookup2D_X_BYTE AXIS_PTS_X 1 SBYTE INDEX_INCR DIRECT /end RECORD_LAYOUT
/begin RECORD_LAYOUT Lookup2D_UWORD FNC_VALUES 1 UWORD COLUMN_DIR DIRECT /end RECORD_LAYOUT
/begin RECORD_LAYOUT Lookup2D_X_UWORD AXIS_PTS_X 1 UWORD INDEX_INCR DIRECT /end RECORD_LAYOUT
/begin RECORD_LAYOUT Lookup2D_WORD FNC_VALUES 1 SWORD COLUMN_DIR DIRECT /end RECORD_LAYOUT
/begin RECORD_LAYOUT Lookup2D_X_WORD AXIS_PTS_X 1 SWORD INDEX_INCR DIRECT /end RECORD_LAYOUT
/begin RECORD_LAYOUT Lookup2D_ULONG FNC_VALUES 1 ULONG COLUMN_DIR DIRECT /end RECORD_LAYOUT
/begin RECORD_LAYOUT Lookup2D_X_ULONG AXIS_PTS_X 1 ULONG INDEX_INCR DIRECT /end RECORD_LAYOUT
/begin RECORD_LAYOUT Lookup2D_LONG FNC_VALUES 1 SLONG COLUMN_DIR DIRECT /end RECORD_LAYOUT
/begin RECORD_LAYOUT Lookup2D_X_LONG AXIS_PTS_X 1 SLONG INDEX_INCR DIRECT /end RECORD_LAYOUT
/begin RECORD_LAYOUT Lookup2D_FLOAT32_IEEE FNC_VALUES 1 FLOAT32_IEEE COLUMN_DIR DIRECT /end RECORD_LAYOUT
/begin RECORD_LAYOUT Lookup2D_X_FLOAT32_IEEE AXIS_PTS_X 1 FLOAT32_IEEE INDEX_INCR DIRECT /end RECORD_LAYOUT
/begin RECORD_LAYOUT Lookup2D_FLOAT64_IEEE FNC_VALUES 1 FLOAT64_IEEE COLUMN_DIR DIRECT /end RECORD_LAYOUT
/begin RECORD_LAYOUT Lookup2D_X_FLOAT64_IEEE AXIS_PTS_X 1 FLOAT64_IEEE INDEX_INCR DIRECT /end RECORD_LAYOUT
/begin CHARACTERISTIC COMM_Phase1 "" VALUE 0x20000008 Scalar_FLOAT64_IEEE 0 HANcoder_E407_TTA_Template_DS_V52_CM_double -1.7E+308 1.7E+308 /end CHARACTERISTIC
/begin CHARACTERISTIC COMM_Phase2 "" VALUE 0x20000010 Scalar_FLOAT64_IEEE 0 HANcoder_E407_TTA_Template_DS_V52_CM_double -1.7E+308 1.7E+308 /end CHARACTERISTIC
/begin CHARACTERISTIC COMM_Phase_init1 "" VALUE 0x20000018 Scalar_FLOAT64_IEEE 0 HANcoder_E407_TTA_Template_DS_V52_CM_double -1.7E+308 1.7E+308 /end CHARACTERISTIC
/begin CHARACTERISTIC COMM_Phase_init2 "" VALUE 0x20000020 Scalar_FLOAT64_IEEE 0 HANcoder_E407_TTA_Template_DS_V52_CM_double -1.7E+308 1.7E+308 /end CHARACTERISTIC
/begin CHARACTERISTIC PID_derivative "" VALUE 0x20000028 Scalar_FLOAT64_IEEE 0 HANcoder_E407_TTA_Template_DS_V52_CM_double -1.7E+308 1.7E+308 /end CHARACTERISTIC
/begin CHARACTERISTIC PID_gain "" VALUE 0x20000030 Scalar_FLOAT64_IEEE 0 HANcoder_E407_TTA_Template_DS_V52_CM_double -1.7E+308 1.7E+308 /end CHARACTERISTIC
/begin CHARACTERISTIC PID_integrator "" VALUE 0x20000038 Scalar_FLOAT64_IEEE 0 HANcoder_E407_TTA_Template_DS_V52_CM_double -1.7E+308 1.7E+308 /end CHARACTERISTIC
/begin CHARACTERISTIC script_run "" VALUE 0x20000040 Scalar_FLOAT64_IEEE 0 HANcoder_E407_TTA_Template_DS_V52_CM_double -1.7E+308 1.7E+308 /end CHARACTERISTIC
/begin MEASUREMENT simulation_time "" FLOAT64_IEEE HANcoder_E407_TTA_Template_DS_V52_CM_double 0 0 -1.7E+308 1.7E+308 ECU_ADDRESS 0x20000f80 /end MEASUREMENT
/begin MEASUREMENT script_run_s "" FLOAT64_IEEE HANcoder_E407_TTA_Template_DS_V52_CM_double 0 0 -1.7E+308 1.7E+308 ECU_ADDRESS 0x20000f78 /end MEASUREMENT
/begin MEASUREMENT Board_ID_s "" FLOAT64_IEEE HANcoder_E407_TTA_Template_DS_V52_CM_double 0 0 -1.7E+308 1.7E+308 ECU_ADDRESS 0x20000690 /end MEASUREMENT
/begin MEASUREMENT Motor_Setpoint_s "" FLOAT64_IEEE HANcoder_E407_TTA_Template_DS_V52_CM_double 0 0 -1.7E+308 1.7E+308 ECU_ADDRESS 0x200006e8 /end MEASUREMENT
/begin MEASUREMENT PosError "" FLOAT64_IEEE HANcoder_E407_TTA_Template_DS_V52_CM_double 0 0 -1.7E+308 1.7E+308 ECU_ADDRESS 0x200006f8 /end MEASUREMENT
/begin MEASUREMENT PosPIDOut "" FLOAT64_IEEE HANcoder_E407_TTA_Template_DS_V52_CM_double 0 0 -1.7E+308 1.7E+308 ECU_ADDRESS 0x20000700 /end MEASUREMENT
/begin MEASUREMENT SI_FreeHeap "" ULONG HANcoder_E407_TTA_Template_DS_V52_CM_uint32 0 0 0 4294967295 ECU_ADDRESS 0x2000075c /end MEASUREMENT
/begin MEASUREMENT SI_FreeStack "" ULONG HANcoder_E407_TTA_Template_DS_V52_CM_uint32 0 0 0 4294967295 ECU_ADDRESS 0x20000760 /end MEASUREMENT
/begin MEASUREMENT Quad_Encoder "" SLONG HANcoder_E407_TTA_Template_DS_V52_CM_int32 0 0 -2147483648 2147483647 ECU_ADDRESS 0x20000718 /end MEASUREMENT
/begin MEASUREMENT RotorPos "" SLONG HANcoder_E407_TTA_Template_DS_V52_CM_int32 0 0 -2147483648 2147483647 ECU_ADDRESS 0x20000728 /end MEASUREMENT
/begin MEASUREMENT Motor_PWM_output "" UWORD HANcoder_E407_TTA_Template_DS_V52_CM_uint16 0 0 0 65535 ECU_ADDRESS 0x200006e0 /end MEASUREMENT
/begin MEASUREMENT local_ticks_interrupt "" UWORD HANcoder_E407_TTA_Template_DS_V52_CM_uint16 0 0 0 65535 ECU_ADDRESS 0x20000884 /end MEASUREMENT
/begin MEASUREMENT SI_CPUload "" UBYTE HANcoder_E407_TTA_Template_DS_V52_CM_uint8 0 0 0 255 ECU_ADDRESS 0x20000758 /end MEASUREMENT
/begin MEASUREMENT Motor_direction2 "" UBYTE HANcoder_E407_TTA_Template_DS_V52_CM_boolean 0 0 0 1 ECU_ADDRESS 0x200006f1 /end MEASUREMENT
/begin MEASUREMENT Motor_direction1 "" UBYTE HANcoder_E407_TTA_Template_DS_V52_CM_boolean 0 0 0 1 ECU_ADDRESS 0x200006f0 /end MEASUREMENT
/begin MEASUREMENT Master_ID_s "" FLOAT64_IEEE HANcoder_E407_TTA_Template_DS_V52_CM_double 0 0 -1.7E+308 1.7E+308 ECU_ADDRESS 0x200006d0 /end MEASUREMENT
/begin MEASUREMENT Role_ID_s "" FLOAT64_IEEE HANcoder_E407_TTA_Template_DS_V52_CM_double 0 0 -1.7E+308 1.7E+308 ECU_ADDRESS 0x20000720 /end MEASUREMENT
/begin MEASUREMENT sync_bc0_miss_counter_s "" FLOAT64_IEEE HANcoder_E407_TTA_Template_DS_V52_CM_double 0 0 -1.7E+308 1.7E+308 ECU_ADDRESS 0x20000f88 /end MEASUREMENT
/begin MEASUREMENT sync_bc1_miss_counter_s "" FLOAT64_IEEE HANcoder_E407_TTA_Template_DS_V52_CM_double 0 0 -1.7E+308 1.7E+308 ECU_ADDRESS 0x20000f90 /end MEASUREMENT
/begin MEASUREMENT votes_Board_1_DEBUG "" FLOAT64_IEEE HANcoder_E407_TTA_Template_DS_V52_CM_double 0 0 -1.7E+308 1.7E+308 ECU_ADDRESS 0x20000f98 /end MEASUREMENT
/begin MEASUREMENT votes_Board_2_DEBUG "" FLOAT64_IEEE HANcoder_E407_TTA_Template_DS_V52_CM_double 0 0 -1.7E+308 1.7E+308 ECU_ADDRESS 0x20000fa0 /end MEASUREMENT
/begin MEASUREMENT votes_Board_3_DEBUG "" FLOAT64_IEEE HANcoder_E407_TTA_Template_DS_V52_CM_double 0 0 -1.7E+308 1.7E+308 ECU_ADDRESS 0x20000fa8 /end MEASUREMENT
/begin MEASUREMENT Board_1_error_counter_s "" FLOAT64_IEEE HANcoder_E407_TTA_Template_DS_V52_CM_double 0 0 -1.7E+308 1.7E+308 ECU_ADDRESS 0x20000678 /end MEASUREMENT
/begin MEASUREMENT Board_2_error_counter_s "" FLOAT64_IEEE HANcoder_E407_TTA_Template_DS_V52_CM_double 0 0 -1.7E+308 1.7E+308 ECU_ADDRESS 0x20000680 /end MEASUREMENT
/begin MEASUREMENT Board_3_error_counter_s "" FLOAT64_IEEE HANcoder_E407_TTA_Template_DS_V52_CM_double 0 0 -1.7E+308 1.7E+308 ECU_ADDRESS 0x20000688 /end MEASUREMENT
/begin MEASUREMENT msg_count_DEBUG_s "" FLOAT64_IEEE HANcoder_E407_TTA_Template_DS_V52_CM_double 0 0 -1.7E+308 1.7E+308 ECU_ADDRESS 0x20000888 /end MEASUREMENT
/begin MEASUREMENT Desync_Sync_bc2_vem_s "" FLOAT64_IEEE HANcoder_E407_TTA_Template_DS_V52_CM_double 0 0 -1.7E+308 1.7E+308 ECU_ADDRESS 0x200006b8 /end MEASUREMENT
/begin MEASUREMENT Trailer_Amount_s "" FLOAT64_IEEE HANcoder_E407_TTA_Template_DS_V52_CM_double 0 0 -1.7E+308 1.7E+308 ECU_ADDRESS 0x20000788 /end MEASUREMENT
/begin MEASUREMENT Delta_I2K_s "" FLOAT64_IEEE HANcoder_E407_TTA_Template_DS_V52_CM_double 0 0 -1.7E+308 1.7E+308 ECU_ADDRESS 0x20000698 /end MEASUREMENT
/begin MEASUREMENT Member1_ID_s "" FLOAT64_IEEE HANcoder_E407_TTA_Template_DS_V52_CM_double 0 0 -1.7E+308 1.7E+308 ECU_ADDRESS 0x200006d8 /end MEASUREMENT
/begin MEASUREMENT Desync_Sync_bc1_s "" FLOAT64_IEEE HANcoder_E407_TTA_Template_DS_V52_CM_double 0 0 -1.7E+308 1.7E+308 ECU_ADDRESS 0x200006a8 /end MEASUREMENT
/begin MEASUREMENT Desync_Sync_bc1_vem_s "" FLOAT64_IEEE HANcoder_E407_TTA_Template_DS_V52_CM_double 0 0 -1.7E+308 1.7E+308 ECU_ADDRESS 0x200006b0 /end MEASUREMENT
/begin MEASUREMENT FCU_Fault_Node "" FLOAT64_IEEE HANcoder_E407_TTA_Template_DS_V52_CM_double 0 0 -1.7E+308 1.7E+308 ECU_ADDRESS 0x200006c0 /end MEASUREMENT
/begin MEASUREMENT FCU_Master "" FLOAT64_IEEE HANcoder_E407_TTA_Template_DS_V52_CM_double 0 0 -1.7E+308 1.7E+308 ECU_ADDRESS 0x200006c8 /end MEASUREMENT
/begin MEASUREMENT Desync_Sync_bc0_s "" FLOAT64_IEEE HANcoder_E407_TTA_Template_DS_V52_CM_double 0 0 -1.7E+308 1.7E+308 ECU_ADDRESS 0x200006a0 /end MEASUREMENT
/begin MEASUREMENT TM1_timeout_counter_s "" FLOAT64_IEEE HANcoder_E407_TTA_Template_DS_V52_CM_double 0 0 -1.7E+308 1.7E+308 ECU_ADDRESS 0x20000768 /end MEASUREMENT
/begin MEASUREMENT TM2_timeout_counter_s "" FLOAT64_IEEE HANcoder_E407_TTA_Template_DS_V52_CM_double 0 0 -1.7E+308 1.7E+308 ECU_ADDRESS 0x20000770 /end MEASUREMENT
/begin MEASUREMENT TM3_timeout_counter_s "" FLOAT64_IEEE HANcoder_E407_TTA_Template_DS_V52_CM_double 0 0 -1.7E+308 1.7E+308 ECU_ADDRESS 0x20000778 /end MEASUREMENT
/begin MEASUREMENT Trailer_ID_s "" FLOAT64_IEEE HANcoder_E407_TTA_Template_DS_V52_CM_double 0 0 -1.7E+308 1.7E+308 ECU_ADDRESS 0x20000790 /end MEASUREMENT
/begin MEASUREMENT Trailer1Articulation_RX_s "" UWORD HANcoder_E407_TTA_Template_DS_V52_CM_uint16 0 0 0 65535 ECU_ADDRESS 0x20000780 /end MEASUREMENT
/begin MEASUREMENT Trailer2Articulation_RX_s "" UWORD HANcoder_E407_TTA_Template_DS_V52_CM_uint16 0 0 0 65535 ECU_ADDRESS 0x20000784 /end MEASUREMENT
/begin MEASUREMENT Steering_Input_s "" UWORD HANcoder_E407_TTA_Template_DS_V52_CM_uint16 0 0 0 65535 ECU_ADDRESS 0x20000764 /end MEASUREMENT
/begin MEASUREMENT ArtAngle1_s "" UWORD HANcoder_E407_TTA_Template_DS_V52_CM_uint16 0 0 0 65535 ECU_ADDRESS 0x20000668 /end MEASUREMENT
/begin MEASUREMENT ArtAngle2_s "" UWORD HANcoder_E407_TTA_Template_DS_V52_CM_uint16 0 0 0 65535 ECU_ADDRESS 0x2000066a /end MEASUREMENT
/begin MEASUREMENT Trailer2_Articulation_s "" UWORD HANcoder_E407_TTA_Template_DS_V52_CM_uint16 0 0 0 65535 ECU_ADDRESS 0x20000786 /end MEASUREMENT
/begin MEASUREMENT Trailer1_Articulation_s "" UWORD HANcoder_E407_TTA_Template_DS_V52_CM_uint16 0 0 0 65535 ECU_ADDRESS 0x20000782 /end MEASUREMENT
/begin MEASUREMENT PotValue1_RX_s "" UWORD HANcoder_E407_TTA_Template_DS_V52_CM_uint16 0 0 0 65535 ECU_ADDRESS 0x20000708 /end MEASUREMENT
/begin MEASUREMENT PotValue2_RX_s "" UWORD HANcoder_E407_TTA_Template_DS_V52_CM_uint16 0 0 0 65535 ECU_ADDRESS 0x2000070c /end MEASUREMENT
/begin MEASUREMENT PotValue3_RX_s "" UWORD HANcoder_E407_TTA_Template_DS_V52_CM_uint16 0 0 0 65535 ECU_ADDRESS 0x20000710 /end MEASUREMENT
/begin MEASUREMENT Pot_Final "" UWORD HANcoder_E407_TTA_Template_DS_V52_CM_uint16 0 0 0 65535 ECU_ADDRESS 0x20000714 /end MEASUREMENT
/begin MEASUREMENT PotValue3_s "" UWORD HANcoder_E407_TTA_Template_DS_V52_CM_uint16 0 0 0 65535 ECU_ADDRESS 0x20000712 /end MEASUREMENT
/begin MEASUREMENT PotValue2_s "" UWORD HANcoder_E407_TTA_Template_DS_V52_CM_uint16 0 0 0 65535 ECU_ADDRESS 0x2000070e /end MEASUREMENT
/begin MEASUREMENT PotValue1_s "" UWORD HANcoder_E407_TTA_Template_DS_V52_CM_uint16 0 0 0 65535 ECU_ADDRESS 0x2000070a /end MEASUREMENT
/begin MEASUREMENT Rx_init_LT "" UWORD HANcoder_E407_TTA_Template_DS_V52_CM_uint16 0 0 0 65535 ECU_ADDRESS 0x2000073c /end MEASUREMENT
/begin MEASUREMENT Vote_s "" UBYTE HANcoder_E407_TTA_Template_DS_V52_CM_uint8 0 0 0 255 ECU_ADDRESS 0x200007b8 /end MEASUREMENT
/begin MEASUREMENT Rx_init_id "" UBYTE HANcoder_E407_TTA_Template_DS_V52_CM_uint8 0 0 0 255 ECU_ADDRESS 0x2000073f /end MEASUREMENT
/begin MEASUREMENT Rx_init_mc "" UBYTE HANcoder_E407_TTA_Template_DS_V52_CM_uint8 0 0 0 255 ECU_ADDRESS 0x20000740 /end MEASUREMENT
/begin MEASUREMENT Rx_init_bc "" UBYTE HANcoder_E407_TTA_Template_DS_V52_CM_uint8 0 0 0 255 ECU_ADDRESS 0x2000073e /end MEASUREMENT
/begin MEASUREMENT bacic_cycle_s "" UBYTE HANcoder_E407_TTA_Template_DS_V52_CM_uint8 0 0 0 255 ECU_ADDRESS 0x200007b9 /end MEASUREMENT
/begin MEASUREMENT basic_cycle_RX_Art1_CAN2 "" UBYTE HANcoder_E407_TTA_Template_DS_V52_CM_ufix2 0 0 0 3.0 ECU_ADDRESS 0x200007bb /end MEASUREMENT
/begin MEASUREMENT basic_cycle_RX_Art1_CAN1 "" UBYTE HANcoder_E407_TTA_Template_DS_V52_CM_ufix2 0 0 0 3.0 ECU_ADDRESS 0x200007ba /end MEASUREMENT
/begin MEASUREMENT BC1_sync_processed_s "" UBYTE HANcoder_E407_TTA_Template_DS_V52_CM_boolean 0 0 0 1 ECU_ADDRESS 0x20000670 /end MEASUREMENT
/begin MEASUREMENT BC0_sync_processed_s "" UBYTE HANcoder_E407_TTA_Template_DS_V52_CM_boolean 0 0 0 1 ECU_ADDRESS 0x2000066c /end MEASUREMENT
/begin MEASUREMENT BC0_vote1_processed_s "" UBYTE HANcoder_E407_TTA_Template_DS_V52_CM_boolean 0 0 0 1 ECU_ADDRESS 0x2000066d /end MEASUREMENT
/begin MEASUREMENT BC0_vote2_processed_s "" UBYTE HANcoder_E407_TTA_Template_DS_V52_CM_boolean 0 0 0 1 ECU_ADDRESS 0x2000066e /end MEASUREMENT
/begin MEASUREMENT BC0_vote3_processed_s "" UBYTE HANcoder_E407_TTA_Template_DS_V52_CM_boolean 0 0 0 1 ECU_ADDRESS 0x2000066f /end MEASUREMENT
/begin MEASUREMENT new_msg_RX_bc2_Art1 "" UBYTE HANcoder_E407_TTA_Template_DS_V52_CM_boolean 0 0 0 1 ECU_ADDRESS 0x20000890 /end MEASUREMENT
/begin MEASUREMENT reset_s "" UBYTE HANcoder_E407_TTA_Template_DS_V52_CM_boolean 0 0 0 1 ECU_ADDRESS 0x20000891 /end MEASUREMENT
/begin MEASUREMENT Tx_temporal_msg_CAN2 "" FLOAT64_IEEE HANcoder_E407_TTA_Template_DS_V52_CM_double 0 0 -1.7E+308 1.7E+308 ECU_ADDRESS 0x200007b0 /end MEASUREMENT
/begin MEASUREMENT TxCAN2_counter_s "" ULONG HANcoder_E407_TTA_Template_DS_V52_CM_uint32 0 0 0 4294967295 ECU_ADDRESS 0x2000079c /end MEASUREMENT
/begin MEASUREMENT TxID_CAN2_s "" ULONG HANcoder_E407_TTA_Template_DS_V52_CM_uint32 0 0 0 4294967295 ECU_ADDRESS 0x200007a4 /end MEASUREMENT
/begin MEASUREMENT Rx_temporal_msg_CAN2 "" FLOAT64_IEEE HANcoder_E407_TTA_Template_DS_V52_CM_double 0 0 -1.7E+308 1.7E+308 ECU_ADDRESS 0x20000750 /end MEASUREMENT
/begin MEASUREMENT RxCAN2_counter_s "" ULONG HANcoder_E407_TTA_Template_DS_V52_CM_uint32 0 0 0 4294967295 ECU_ADDRESS 0x20000730 /end MEASUREMENT
/begin MEASUREMENT RxID_CAN2_s "" ULONG HANcoder_E407_TTA_Template_DS_V52_CM_uint32 0 0 0 4294967295 ECU_ADDRESS 0x20000738 /end MEASUREMENT
/begin MEASUREMENT Rx_msg_ticks_CAN2 "" UWORD HANcoder_E407_TTA_Template_DS_V52_CM_uint16 0 0 0 65535 ECU_ADDRESS 0x20000744 /end MEASUREMENT
/begin MEASUREMENT Rx_temporal_msg_CAN1 "" FLOAT64_IEEE HANcoder_E407_TTA_Template_DS_V52_CM_double 0 0 -1.7E+308 1.7E+308 ECU_ADDRESS 0x20000748 /end MEASUREMENT
/begin MEASUREMENT RxCAN1_counter_s "" ULONG HANcoder_E407_TTA_Template_DS_V52_CM_uint32 0 0 0 4294967295 ECU_ADDRESS 0x2000072c /end MEASUREMENT
/begin MEASUREMENT RxID_CAN1_s "" ULONG HANcoder_E407_TTA_Template_DS_V52_CM_uint32 0 0 0 4294967295 ECU_ADDRESS 0x20000734 /end MEASUREMENT
/begin MEASUREMENT Rx_msg_ticks_CAN1 "" UWORD HANcoder_E407_TTA_Template_DS_V52_CM_uint16 0 0 0 65535 ECU_ADDRESS 0x20000742 /end MEASUREMENT
/begin MEASUREMENT Tx_temporal_msg_CAN1 "" FLOAT64_IEEE HANcoder_E407_TTA_Template_DS_V52_CM_double 0 0 -1.7E+308 1.7E+308 ECU_ADDRESS 0x200007a8 /end MEASUREMENT
/begin MEASUREMENT TxCAN1_counter_s "" ULONG HANcoder_E407_TTA_Template_DS_V52_CM_uint32 0 0 0 4294967295 ECU_ADDRESS 0x20000798 /end MEASUREMENT
/begin MEASUREMENT TxID_CAN1_s "" ULONG HANcoder_E407_TTA_Template_DS_V52_CM_uint32 0 0 0 4294967295 ECU_ADDRESS 0x200007a0 /end MEASUREMENT
/begin COMPU_METHOD HANcoder_E407_TTA_Template_DS_V52_CM_double "Q = V" RAT_FUNC "%15.10" "" COEFFS 0 1 0 0 0 1 /end COMPU_METHOD
/begin COMPU_METHOD HANcoder_E407_TTA_Template_DS_V52_CM_uint32 "Q = V" RAT_FUNC "%10.0" "" COEFFS 0 1 0 0 0 1 /end COMPU_METHOD
/begin COMPU_METHOD HANcoder_E407_TTA_Template_DS_V52_CM_int32 "Q = V" RAT_FUNC "%10.0" "" COEFFS 0 1 0 0 0 1 /end COMPU_METHOD
/begin COMPU_METHOD HANcoder_E407_TTA_Template_DS_V52_CM_uint16 "Q = V" RAT_FUNC "%5.0" "" COEFFS 0 1 0 0 0 1 /end COMPU_METHOD
/begin COMPU_METHOD HANcoder_E407_TTA_Template_DS_V52_CM_uint8 "Q = V" RAT_FUNC "%3.0" "" COEFFS 0 1 0 0 0 1 /end COMPU_METHOD
/begin COMPU_METHOD HANcoder_E407_TTA_Template_DS_V52_CM_boolean "Q = V" RAT_FUNC "%1.0" "" COEFFS 0 1 0 0 0 1 /end COMPU_METHOD
/begin COMPU_METHOD HANcoder_E407_TTA_Template_DS_V52_CM_ufix2 "Q = V/1.000000" RAT_FUNC "%3.0" "" COEFFS 0 1.000000 0.000000 0 0 1.000000 /end COMPU_METHOD
/begin GROUP HANcoder_E407_TTA_Template_DS_V52 "HANcoder_E407_TTA_Template_DS_V52" /* Root */ ROOT /begin SUB_GROUP Root_HANcoder_STM32_Target___E407_STM32_algorithm /end SUB_GROUP /end GROUP
/begin GROUP Root_HANcoder_STM32_Target___E407_STM32_algorithm "HANcoder_E407_TTA_Template_DS_V52/HANcoder STM32 Target - E407-STM32 algorithm" /begin SUB_GROUP S1_System_information S1_TTA_CAN_System /end SUB_GROUP /end GROUP
/begin GROUP S1_System_information "HANcoder_E407_TTA_Template_DS_V52/HANcoder STM32 Target - E407-STM32 algorithm/System information" /begin SUB_GROUP S8_Get_CPU_load S8_Get_free_Heap S8_Get_free_Stack /end SUB_GROUP /end GROUP
/begin GROUP S1_TTA_CAN_System "HANcoder_E407_TTA_Template_DS_V52/HANcoder STM32 Target - E407-STM32 algorithm/TTA CAN System"
 /begin SUB_GROUP S9_CAN1_Recieve1 S9_CAN1_Send S9_CAN2_Recieve1 S9_CAN2_Send S9_Enabled_Subsystem S9_If_Action_Subsystem S9_Local_Time_generation S9_TTA_System /end SUB_GROUP
 /begin REF_CHARACTERISTIC script_run /end REF_CHARACTERISTIC
 /begin REF_MEASUREMENT script_run_s simulation_time /end REF_MEASUREMENT
/end GROUP
/begin GROUP S8_Get_CPU_load "HANcoder_E407_TTA_Template_DS_V52/HANcoder STM32 Target - E407-STM32 algorithm/System information/Get CPU load" /begin REF_MEASUREMENT SI_CPUload /end REF_MEASUREMENT /end GROUP
/begin GROUP S8_Get_free_Heap "HANcoder_E407_TTA_Template_DS_V52/HANcoder STM32 Target - E407-STM32 algorithm/System information/Get free Heap" /begin REF_MEASUREMENT SI_FreeHeap /end REF_MEASUREMENT /end GROUP
/begin GROUP S8_Get_free_Stack "HANcoder_E407_TTA_Template_DS_V52/HANcoder STM32 Target - E407-STM32 algorithm/System information/Get free Stack" /begin REF_MEASUREMENT SI_FreeStack /end REF_MEASUREMENT /end GROUP
/begin GROUP S9_CAN1_Recieve1 "HANcoder_E407_TTA_Template_DS_V52/HANcoder STM32 Target - E407-STM32 algorithm/TTA CAN System/CAN1 Recieve1" /begin SUB_GROUP S18_Update_message_buffers /end SUB_GROUP /begin REF_MEASUREMENT RxCAN1_counter_s RxID_CAN1_s /end REF_MEASUREMENT /end GROUP
/begin GROUP S9_CAN1_Send "HANcoder_E407_TTA_Template_DS_V52/HANcoder STM32 Target - E407-STM32 algorithm/TTA CAN System/CAN1 Send" /begin REF_MEASUREMENT TxCAN1_counter_s TxID_CAN1_s Tx_temporal_msg_CAN1 /end REF_MEASUREMENT /end GROUP
/begin GROUP S9_CAN2_Recieve1 "HANcoder_E407_TTA_Template_DS_V52/HANcoder STM32 Target - E407-STM32 algorithm/TTA CAN System/CAN2 Recieve1" /begin SUB_GROUP S20_Update_message_buffers /end SUB_GROUP /begin REF_MEASUREMENT RxCAN2_counter_s RxID_CAN2_s /end REF_MEASUREMENT /end GROUP
/begin GROUP S9_CAN2_Send "HANcoder_E407_TTA_Template_DS_V52/HANcoder STM32 Target - E407-STM32 algorithm/TTA CAN System/CAN2 Send" /begin REF_MEASUREMENT TxCAN2_counter_s TxID_CAN2_s Tx_temporal_msg_CAN2 /end REF_MEASUREMENT /end GROUP
/begin GROUP S9_Enabled_Subsystem "HANcoder_E407_TTA_Template_DS_V52/HANcoder STM32 Target - E407-STM32 algorithm/TTA CAN System/Enabled Subsystem" /begin SUB_GROUP S23_Position_Control S23_Quadrature_Encoder_Get /end SUB_GROUP
 /begin REF_MEASUREMENT Motor_Setpoint_s Motor_direction1 Motor_direction2 RotorPos /end REF_MEASUREMENT
/end GROUP
/begin GROUP S9_If_Action_Subsystem "HANcoder_E407_TTA_Template_DS_V52/HANcoder STM32 Target - E407-STM32 algorithm/TTA CAN System/If Action Subsystem" /begin REF_MEASUREMENT Board_ID_s /end REF_MEASUREMENT /end GROUP
/begin GROUP S9_Local_Time_generation "HANcoder_E407_TTA_Template_DS_V52/HANcoder STM32 Target - E407-STM32 algorithm/TTA CAN System/Local Time generation" /begin REF_MEASUREMENT local_ticks_interrupt /end REF_MEASUREMENT /end GROUP
/begin GROUP S9_TTA_System "HANcoder_E407_TTA_Template_DS_V52/HANcoder STM32 Target - E407-STM32 algorithm/TTA CAN System/TTA System"
 /begin SUB_GROUP S29_Basic_Cycle_Increment S29_Initialization S29_LT_Update_Desync_Positive S29_Matrix_Cycle_Manager /end SUB_GROUP
/end GROUP
/begin GROUP S18_Update_message_buffers "HANcoder_E407_TTA_Template_DS_V52/HANcoder STM32 Target - E407-STM32 algorithm/TTA CAN System/CAN1 Recieve1/Update message buffers" /begin REF_MEASUREMENT Rx_msg_ticks_CAN1 Rx_temporal_msg_CAN1 /end REF_MEASUREMENT /end GROUP
/begin GROUP S20_Update_message_buffers "HANcoder_E407_TTA_Template_DS_V52/HANcoder STM32 Target - E407-STM32 algorithm/TTA CAN System/CAN2 Recieve1/Update message buffers" /begin REF_MEASUREMENT Rx_msg_ticks_CAN2 Rx_temporal_msg_CAN2 /end REF_MEASUREMENT /end GROUP
/begin GROUP S23_Position_Control "HANcoder_E407_TTA_Template_DS_V52/HANcoder STM32 Target - E407-STM32 algorithm/TTA CAN System/Enabled Subsystem/Position Control" /begin REF_MEASUREMENT Motor_PWM_output PosError /end REF_MEASUREMENT /end GROUP
/begin GROUP S23_Quadrature_Encoder_Get "HANcoder_E407_TTA_Template_DS_V52/HANcoder STM32 Target - E407-STM32 algorithm/TTA CAN System/Enabled Subsystem/Quadrature Encoder Get" /begin REF_MEASUREMENT Quad_Encoder /end REF_MEASUREMENT /end GROUP
/begin GROUP S29_Basic_Cycle_Increment "HANcoder_E407_TTA_Template_DS_V52/HANcoder STM32 Target - E407-STM32 algorithm/TTA CAN System/TTA System/Basic Cycle Increment" /begin REF_MEASUREMENT bacic_cycle_s /end REF_MEASUREMENT /end GROUP
/begin GROUP S29_Initialization "HANcoder_E407_TTA_Template_DS_V52/HANcoder STM32 Target - E407-STM32 algorithm/TTA CAN System/TTA System/Initialization" /begin SUB_GROUP S196_RoleID_and_Global_Time_init /end SUB_GROUP /begin REF_MEASUREMENT Trailer_ID_s /end REF_MEASUREMENT /end GROUP
/begin GROUP S29_LT_Update_Desync_Positive "HANcoder_E407_TTA_Template_DS_V52/HANcoder STM32 Target - E407-STM32 algorithm/TTA CAN System/TTA System/LT_Update Desync_Positive" /begin REF_CHARACTERISTIC COMM_Phase1 COMM_Phase2 COMM_Phase_init1 COMM_Phase_init2 /end REF_CHARACTERISTIC /end GROUP
/begin GROUP S29_Matrix_Cycle_Manager "HANcoder_E407_TTA_Template_DS_V52/HANcoder STM32 Target - E407-STM32 algorithm/TTA CAN System/TTA System/Matrix Cycle Manager" /begin SUB_GROUP S202_Controller_Matrix_Cycle /end SUB_GROUP /end GROUP
/begin GROUP S196_RoleID_and_Global_Time_init "HANcoder_E407_TTA_Template_DS_V52/HANcoder STM32 Target - E407-STM32 algorithm/TTA CAN System/TTA System/Initialization/RoleID and Global Time init" /begin SUB_GROUP S212_Global_Time_Initialization_Slave /end SUB_GROUP /end GROUP
/begin GROUP S202_Controller_Matrix_Cycle "HANcoder_E407_TTA_Template_DS_V52/HANcoder STM32 Target - E407-STM32 algorithm/TTA CAN System/TTA System/Matrix Cycle Manager/Controller Matrix Cycle"
 /begin SUB_GROUP S232_Matrix_Cycle_Observation_DEBUG S232_controller_basic_cycle_0 S232_controller_basic_cycle_1 S232_controller_basic_cycle_2 S232_msg_count_DEBUG_observer /end SUB_GROUP
/end GROUP
/begin GROUP S212_Global_Time_Initialization_Slave "HANcoder_E407_TTA_Template_DS_V52/HANcoder STM32 Target - E407-STM32 algorithm/TTA CAN System/TTA System/Initialization/RoleID and Global Time init/Global Time Initialization Slave" /begin SUB_GROUP S214_msg_decoding /end SUB_GROUP /begin REF_CHARACTERISTIC COMM_Phase1 COMM_Phase2 /end REF_CHARACTERISTIC /begin REF_MEASUREMENT Rx_init_LT /end REF_MEASUREMENT /end GROUP
/begin GROUP S232_Matrix_Cycle_Observation_DEBUG "HANcoder_E407_TTA_Template_DS_V52/HANcoder STM32 Target - E407-STM32 algorithm/TTA CAN System/TTA System/Matrix Cycle Manager/Controller Matrix Cycle/Matrix_Cycle_Observation_DEBUG"
 /begin REF_MEASUREMENT BC0_sync_processed_s BC0_vote1_processed_s BC0_vote2_processed_s BC0_vote3_processed_s BC1_sync_processed_s Board_1_error_counter_s Board_2_error_counter_s Board_3_error_counter_s Master_ID_s Role_ID_s sync_bc0_miss_counter_s sync_bc1_miss_counter_s votes_Board_1_DEBUG votes_Board_2_DEBUG votes_Board_3_DEBUG /end REF_MEASUREMENT
/end GROUP
/begin GROUP S232_controller_basic_cycle_0 "HANcoder_E407_TTA_Template_DS_V52/HANcoder STM32 Target - E407-STM32 algorithm/TTA CAN System/TTA System/Matrix Cycle Manager/Controller Matrix Cycle/controller basic cycle 0"
 /begin SUB_GROUP S234_COMM_Task___Sync_bc_0 S234_COMM_Task___Vote1 S234_COMM_Task___Vote2 S234_COMM_Task___Vote3 S234_COMP_Task___Check_Timeouts S234_COMP_Task___Reset_Board S234_COMP_Task___Sync_bc0_check S234_COMP_Task___Vote_Decision /end SUB_GROUP
/end GROUP
/begin GROUP S232_controller_basic_cycle_1 "HANcoder_E407_TTA_Template_DS_V52/HANcoder STM32 Target - E407-STM32 algorithm/TTA CAN System/TTA System/Matrix Cycle Manager/Controller Matrix Cycle/controller basic cycle 1"
 /begin SUB_GROUP S235_COMM_Task___PotValue_trailer_1 S235_COMM_Task___PotValue_trailer_2 S235_COMM_Task___PotValue_trailer_3 S235_COMM_Task___Sync_bc_1 S235_COMP_Task___Potentiometer_Voting S235_COMP_Task___Rx_PotValues1_check S235_COMP_Task___Rx_PotValues2_check S235_COMP_Task___Rx_PotValues3_check S235_COMP_Task___Sync_bc1_check /end SUB_GROUP
/end GROUP
/begin GROUP S232_controller_basic_cycle_2 "HANcoder_E407_TTA_Template_DS_V52/HANcoder STM32 Target - E407-STM32 algorithm/TTA CAN System/TTA System/Matrix Cycle Manager/Controller Matrix Cycle/controller basic cycle 2"
 /begin SUB_GROUP S236_COMM_Task___Articualtion_angle_trailer_1 S236_COMM_Task___Articualtion_angle_trailer_2 S236_COMM_Task___Sync_bc_1 S236_COMP_Task___Inverse_Kinematics_Model S236_COMP_Task___Rx_PotValues2_check S236_COMP_Task___Rx_Trailer1Articulation_check S236_COMP_Task___Sync_bc1_check /end SUB_GROUP
/end GROUP
/begin GROUP S232_msg_count_DEBUG_observer "HANcoder_E407_TTA_Template_DS_V52/HANcoder STM32 Target - E407-STM32 algorithm/TTA CAN System/TTA System/Matrix Cycle Manager/Controller Matrix Cycle/msg_count_DEBUG observer" /begin REF_MEASUREMENT msg_count_DEBUG_s /end REF_MEASUREMENT /end GROUP
/begin GROUP S125_Internal_Parameters "HANcoder_E407_TTA_Template_DS_V52/HANcoder STM32 Target - E407-STM32 algorithm/TTA CAN System/Enabled Subsystem/Position Control/Discrete PID Controller/D Gain/Internal Parameters" /begin REF_CHARACTERISTIC PID_derivative /end REF_CHARACTERISTIC /end GROUP
/begin GROUP S128_Internal_Parameters "HANcoder_E407_TTA_Template_DS_V52/HANcoder STM32 Target - E407-STM32 algorithm/TTA CAN System/Enabled Subsystem/Position Control/Discrete PID Controller/I Gain/Internal Parameters" /begin REF_CHARACTERISTIC PID_integrator /end REF_CHARACTERISTIC /end GROUP
/begin GROUP S129_Internal_Parameters "HANcoder_E407_TTA_Template_DS_V52/HANcoder STM32 Target - E407-STM32 algorithm/TTA CAN System/Enabled Subsystem/Position Control/Discrete PID Controller/Ideal P Gain/Internal Parameters" /begin REF_CHARACTERISTIC PID_gain /end REF_CHARACTERISTIC /end GROUP
/begin GROUP S138_Enabled "HANcoder_E407_TTA_Template_DS_V52/HANcoder STM32 Target - E407-STM32 algorithm/TTA CAN System/Enabled Subsystem/Position Control/Discrete PID Controller/Saturation/Enabled" /begin REF_MEASUREMENT PosPIDOut /end REF_MEASUREMENT /end GROUP
/begin GROUP S214_msg_decoding "HANcoder_E407_TTA_Template_DS_V52/HANcoder STM32 Target - E407-STM32 algorithm/TTA CAN System/TTA System/Initialization/RoleID and Global Time init/Global Time Initialization Slave/msg_decoding" /begin SUB_GROUP S215_Bit_Shift S215_Bit_Shift1 S215_Bit_Shift2 /end SUB_GROUP /end GROUP
/begin GROUP S234_COMM_Task___Sync_bc_0 "HANcoder_E407_TTA_Template_DS_V52/HANcoder STM32 Target - E407-STM32 algorithm/TTA CAN System/TTA System/Matrix Cycle Manager/Controller Matrix Cycle/controller basic cycle 0/COMM Task - Sync bc 0" /begin SUB_GROUP S238_Transmission_subtasks /end SUB_GROUP /end GROUP
/begin GROUP S234_COMM_Task___Vote1 "HANcoder_E407_TTA_Template_DS_V52/HANcoder STM32 Target - E407-STM32 algorithm/TTA CAN System/TTA System/Matrix Cycle Manager/Controller Matrix Cycle/controller basic cycle 0/COMM Task - Vote1" /begin SUB_GROUP S239_Transmission_subtasks /end SUB_GROUP /end GROUP
/begin GROUP S234_COMM_Task___Vote2 "HANcoder_E407_TTA_Template_DS_V52/HANcoder STM32 Target - E407-STM32 algorithm/TTA CAN System/TTA System/Matrix Cycle Manager/Controller Matrix Cycle/controller basic cycle 0/COMM Task - Vote2" /begin SUB_GROUP S240_Transmission_subtasks /end SUB_GROUP /end GROUP
/begin GROUP S234_COMM_Task___Vote3 "HANcoder_E407_TTA_Template_DS_V52/HANcoder STM32 Target - E407-STM32 algorithm/TTA CAN System/TTA System/Matrix Cycle Manager/Controller Matrix Cycle/controller basic cycle 0/COMM Task - Vote3" /begin SUB_GROUP S241_Transmission_subtasks /end SUB_GROUP /end GROUP
/begin GROUP S234_COMP_Task___Check_Timeouts "HANcoder_E407_TTA_Template_DS_V52/HANcoder STM32 Target - E407-STM32 algorithm/TTA CAN System/TTA System/Matrix Cycle Manager/Controller Matrix Cycle/controller basic cycle 0/COMP Task - Check Timeouts" /begin SUB_GROUP S242_Timeout_and_Board_error_counter /end SUB_GROUP /end GROUP
/begin GROUP S234_COMP_Task___Reset_Board "HANcoder_E407_TTA_Template_DS_V52/HANcoder STM32 Target - E407-STM32 algorithm/TTA CAN System/TTA System/Matrix Cycle Manager/Controller Matrix Cycle/controller basic cycle 0/COMP Task - Reset Board" /begin REF_MEASUREMENT reset_s /end REF_MEASUREMENT /end GROUP
/begin GROUP S234_COMP_Task___Sync_bc0_check "HANcoder_E407_TTA_Template_DS_V52/HANcoder STM32 Target - E407-STM32 algorithm/TTA CAN System/TTA System/Matrix Cycle Manager/Controller Matrix Cycle/controller basic cycle 0/COMP Task - Sync bc0 check" /begin SUB_GROUP S246_Process_Messages /end SUB_GROUP /end GROUP
/begin GROUP S234_COMP_Task___Vote_Decision "HANcoder_E407_TTA_Template_DS_V52/HANcoder STM32 Target - E407-STM32 algorithm/TTA CAN System/TTA System/Matrix Cycle Manager/Controller Matrix Cycle/controller basic cycle 0/COMP Task - Vote Decision" /begin SUB_GROUP S248_Vote_Decision /end SUB_GROUP /end GROUP
/begin GROUP S235_COMM_Task___PotValue_trailer_1 "HANcoder_E407_TTA_Template_DS_V52/HANcoder STM32 Target - E407-STM32 algorithm/TTA CAN System/TTA System/Matrix Cycle Manager/Controller Matrix Cycle/controller basic cycle 1/COMM Task - PotValue trailer 1" /begin SUB_GROUP S459_Transmission_subtasks /end SUB_GROUP /end GROUP
/begin GROUP S235_COMM_Task___PotValue_trailer_2 "HANcoder_E407_TTA_Template_DS_V52/HANcoder STM32 Target - E407-STM32 algorithm/TTA CAN System/TTA System/Matrix Cycle Manager/Controller Matrix Cycle/controller basic cycle 1/COMM Task - PotValue trailer 2" /begin SUB_GROUP S460_Transmission_subtasks /end SUB_GROUP /end GROUP
/begin GROUP S235_COMM_Task___PotValue_trailer_3 "HANcoder_E407_TTA_Template_DS_V52/HANcoder STM32 Target - E407-STM32 algorithm/TTA CAN System/TTA System/Matrix Cycle Manager/Controller Matrix Cycle/controller basic cycle 1/COMM Task - PotValue trailer 3" /begin SUB_GROUP S461_Transmission_subtasks /end SUB_GROUP /end GROUP
/begin GROUP S235_COMM_Task___Sync_bc_1 "HANcoder_E407_TTA_Template_DS_V52/HANcoder STM32 Target - E407-STM32 algorithm/TTA CAN System/TTA System/Matrix Cycle Manager/Controller Matrix Cycle/controller basic cycle 1/COMM Task - Sync bc 1" /begin SUB_GROUP S462_Transmission_subtasks1 /end SUB_GROUP /end GROUP
/begin GROUP S235_COMP_Task___Potentiometer_Voting "HANcoder_E407_TTA_Template_DS_V52/HANcoder STM32 Target - E407-STM32 algorithm/TTA CAN System/TTA System/Matrix Cycle Manager/Controller Matrix Cycle/controller basic cycle 1/COMP Task - Potentiometer Voting"
 /begin REF_MEASUREMENT FCU_Fault_Node FCU_Master PotValue1_RX_s PotValue2_RX_s PotValue3_RX_s Pot_Final /end REF_MEASUREMENT
/end GROUP
/begin GROUP S235_COMP_Task___Rx_PotValues1_check "HANcoder_E407_TTA_Template_DS_V52/HANcoder STM32 Target - E407-STM32 algorithm/TTA CAN System/TTA System/Matrix Cycle Manager/Controller Matrix Cycle/controller basic cycle 1/COMP Task - Rx_PotValues1_check" /begin SUB_GROUP S465_Process_Messages /end SUB_GROUP /end GROUP
/begin GROUP S235_COMP_Task___Rx_PotValues2_check "HANcoder_E407_TTA_Template_DS_V52/HANcoder STM32 Target - E407-STM32 algorithm/TTA CAN System/TTA System/Matrix Cycle Manager/Controller Matrix Cycle/controller basic cycle 1/COMP Task - Rx_PotValues2_check" /begin SUB_GROUP S467_Process_Messages /end SUB_GROUP /end GROUP
/begin GROUP S235_COMP_Task___Rx_PotValues3_check "HANcoder_E407_TTA_Template_DS_V52/HANcoder STM32 Target - E407-STM32 algorithm/TTA CAN System/TTA System/Matrix Cycle Manager/Controller Matrix Cycle/controller basic cycle 1/COMP Task - Rx_PotValues3_check" /begin SUB_GROUP S468_Process_Messages /end SUB_GROUP /end GROUP
/begin GROUP S235_COMP_Task___Sync_bc1_check "HANcoder_E407_TTA_Template_DS_V52/HANcoder STM32 Target - E407-STM32 algorithm/TTA CAN System/TTA System/Matrix Cycle Manager/Controller Matrix Cycle/controller basic cycle 1/COMP Task - Sync bc1 check" /begin SUB_GROUP S469_Process_Messages /end SUB_GROUP /end GROUP
/begin GROUP S236_COMM_Task___Articualtion_angle_trailer_1 "HANcoder_E407_TTA_Template_DS_V52/HANcoder STM32 Target - E407-STM32 algorithm/TTA CAN System/TTA System/Matrix Cycle Manager/Controller Matrix Cycle/controller basic cycle 2/COMM Task - Articualtion angle trailer 1" /begin SUB_GROUP S688_Transmission_subtasks /end SUB_GROUP /end GROUP
/begin GROUP S236_COMM_Task___Articualtion_angle_trailer_2 "HANcoder_E407_TTA_Template_DS_V52/HANcoder STM32 Target - E407-STM32 algorithm/TTA CAN System/TTA System/Matrix Cycle Manager/Controller Matrix Cycle/controller basic cycle 2/COMM Task - Articualtion angle trailer 2" /begin SUB_GROUP S689_Transmission_subtasks /end SUB_GROUP /end GROUP
/begin GROUP S236_COMM_Task___Sync_bc_1 "HANcoder_E407_TTA_Template_DS_V52/HANcoder STM32 Target - E407-STM32 algorithm/TTA CAN System/TTA System/Matrix Cycle Manager/Controller Matrix Cycle/controller basic cycle 2/COMM Task - Sync bc 1" /begin SUB_GROUP S690_Transmission_subtasks1 /end SUB_GROUP /end GROUP
/begin GROUP S236_COMP_Task___Inverse_Kinematics_Model "HANcoder_E407_TTA_Template_DS_V52/HANcoder STM32 Target - E407-STM32 algorithm/TTA CAN System/TTA System/Matrix Cycle Manager/Controller Matrix Cycle/controller basic cycle 2/COMP Task - Inverse Kinematics Model" /begin SUB_GROUP S691_Enabled_Subsystem /end SUB_GROUP /end GROUP
/begin GROUP S236_COMP_Task___Rx_PotValues2_check "HANcoder_E407_TTA_Template_DS_V52/HANcoder STM32 Target - E407-STM32 algorithm/TTA CAN System/TTA System/Matrix Cycle Manager/Controller Matrix Cycle/controller basic cycle 2/COMP Task - Rx_PotValues2_check" /begin SUB_GROUP S693_Process_Messages /end SUB_GROUP /end GROUP
/begin GROUP S236_COMP_Task___Rx_Trailer1Articulation_check "HANcoder_E407_TTA_Template_DS_V52/HANcoder STM32 Target - E407-STM32 algorithm/TTA CAN System/TTA System/Matrix Cycle Manager/Controller Matrix Cycle/controller basic cycle 2/COMP Task - Rx_Trailer1Articulation_check" /begin SUB_GROUP S694_Process_Messages /end SUB_GROUP /end GROUP
/begin GROUP S236_COMP_Task___Sync_bc1_check "HANcoder_E407_TTA_Template_DS_V52/HANcoder STM32 Target - E407-STM32 algorithm/TTA CAN System/TTA System/Matrix Cycle Manager/Controller Matrix Cycle/controller basic cycle 2/COMP Task - Sync bc1 check" /begin SUB_GROUP S696_Process_Messages /end SUB_GROUP /end GROUP
/begin GROUP S215_Bit_Shift "HANcoder_E407_TTA_Template_DS_V52/HANcoder STM32 Target - E407-STM32 algorithm/TTA CAN System/TTA System/Initialization/RoleID and Global Time init/Global Time Initialization Slave/msg_decoding/Bit Shift" /begin REF_MEASUREMENT Rx_init_bc /end REF_MEASUREMENT /end GROUP
/begin GROUP S215_Bit_Shift1 "HANcoder_E407_TTA_Template_DS_V52/HANcoder STM32 Target - E407-STM32 algorithm/TTA CAN System/TTA System/Initialization/RoleID and Global Time init/Global Time Initialization Slave/msg_decoding/Bit Shift1" /begin REF_MEASUREMENT Rx_init_mc /end REF_MEASUREMENT /end GROUP
/begin GROUP S215_Bit_Shift2 "HANcoder_E407_TTA_Template_DS_V52/HANcoder STM32 Target - E407-STM32 algorithm/TTA CAN System/TTA System/Initialization/RoleID and Global Time init/Global Time Initialization Slave/msg_decoding/Bit Shift2" /begin REF_MEASUREMENT Rx_init_id /end REF_MEASUREMENT /end GROUP
/begin GROUP S238_Transmission_subtasks "HANcoder_E407_TTA_Template_DS_V52/HANcoder STM32 Target - E407-STM32 algorithm/TTA CAN System/TTA System/Matrix Cycle Manager/Controller Matrix Cycle/controller basic cycle 0/COMM Task - Sync bc 0/Transmission subtasks"
 /begin SUB_GROUP S256_Check_msg_transmission_CAN1 S256_Check_msg_transmission_CAN2 /end SUB_GROUP
/end GROUP
/begin GROUP S239_Transmission_subtasks "HANcoder_E407_TTA_Template_DS_V52/HANcoder STM32 Target - E407-STM32 algorithm/TTA CAN System/TTA System/Matrix Cycle Manager/Controller Matrix Cycle/controller basic cycle 0/COMM Task - Vote1/Transmission subtasks"
 /begin SUB_GROUP S274_Check_msg_transmission_CAN1 S274_Check_msg_transmission_CAN2 /end SUB_GROUP
/end GROUP
/begin GROUP S240_Transmission_subtasks "HANcoder_E407_TTA_Template_DS_V52/HANcoder STM32 Target - E407-STM32 algorithm/TTA CAN System/TTA System/Matrix Cycle Manager/Controller Matrix Cycle/controller basic cycle 0/COMM Task - Vote2/Transmission subtasks"
 /begin SUB_GROUP S292_Check_msg_transmission_CAN1 S292_Check_msg_transmission_CAN2 /end SUB_GROUP
/end GROUP
/begin GROUP S241_Transmission_subtasks "HANcoder_E407_TTA_Template_DS_V52/HANcoder STM32 Target - E407-STM32 algorithm/TTA CAN System/TTA System/Matrix Cycle Manager/Controller Matrix Cycle/controller basic cycle 0/COMM Task - Vote3/Transmission subtasks"
 /begin SUB_GROUP S310_Check_msg_transmission_CAN1 S310_Check_msg_transmission_CAN2 /end SUB_GROUP
/end GROUP
/begin GROUP S242_Timeout_and_Board_error_counter "HANcoder_E407_TTA_Template_DS_V52/HANcoder STM32 Target - E407-STM32 algorithm/TTA CAN System/TTA System/Matrix Cycle Manager/Controller Matrix Cycle/controller basic cycle 0/COMP Task - Check Timeouts/Timeout and Board error counter"
 /begin SUB_GROUP S327_Timeout_Counter_1_DEBUG S327_Timeout_Counter_2_DEBUG S327_Timeout_Counter_3_DEBUG /end SUB_GROUP
/end GROUP
/begin GROUP S246_Process_Messages "HANcoder_E407_TTA_Template_DS_V52/HANcoder STM32 Target - E407-STM32 algorithm/TTA CAN System/TTA System/Matrix Cycle Manager/Controller Matrix Cycle/controller basic cycle 0/COMP Task - Sync bc0 check/Process_Messages" /begin SUB_GROUP S336_Desync_calculation /end SUB_GROUP /end GROUP
/begin GROUP S248_Vote_Decision "HANcoder_E407_TTA_Template_DS_V52/HANcoder STM32 Target - E407-STM32 algorithm/TTA CAN System/TTA System/Matrix Cycle Manager/Controller Matrix Cycle/controller basic cycle 0/COMP Task - Vote Decision/Vote Decision" /begin REF_MEASUREMENT Vote_s /end REF_MEASUREMENT /end GROUP
/begin GROUP S459_Transmission_subtasks "HANcoder_E407_TTA_Template_DS_V52/HANcoder STM32 Target - E407-STM32 algorithm/TTA CAN System/TTA System/Matrix Cycle Manager/Controller Matrix Cycle/controller basic cycle 1/COMM Task - PotValue trailer 1/Transmission subtasks"
 /begin SUB_GROUP S472_Check_msg_transmission_CAN1 S472_Check_msg_transmission_CAN2 S472_Msg_Value_Data_Encoded /end SUB_GROUP
/end GROUP
/begin GROUP S460_Transmission_subtasks "HANcoder_E407_TTA_Template_DS_V52/HANcoder STM32 Target - E407-STM32 algorithm/TTA CAN System/TTA System/Matrix Cycle Manager/Controller Matrix Cycle/controller basic cycle 1/COMM Task - PotValue trailer 2/Transmission subtasks"
 /begin SUB_GROUP S492_Check_msg_transmission_CAN1 S492_Check_msg_transmission_CAN2 S492_Msg_Value_Data_Encoded /end SUB_GROUP
/end GROUP
/begin GROUP S461_Transmission_subtasks "HANcoder_E407_TTA_Template_DS_V52/HANcoder STM32 Target - E407-STM32 algorithm/TTA CAN System/TTA System/Matrix Cycle Manager/Controller Matrix Cycle/controller basic cycle 1/COMM Task - PotValue trailer 3/Transmission subtasks"
 /begin SUB_GROUP S512_Check_msg_transmission_CAN1 S512_Check_msg_transmission_CAN2 S512_Msg_Value_Data_Encoded /end SUB_GROUP
/end GROUP
/begin GROUP S462_Transmission_subtasks1 "HANcoder_E407_TTA_Template_DS_V52/HANcoder STM32 Target - E407-STM32 algorithm/TTA CAN System/TTA System/Matrix Cycle Manager/Controller Matrix Cycle/controller basic cycle 1/COMM Task - Sync bc 1/Transmission subtasks1"
 /begin SUB_GROUP S532_Check_msg_transmission_CAN1 S532_Check_msg_transmission_CAN2 /end SUB_GROUP
/end GROUP
/begin GROUP S465_Process_Messages "HANcoder_E407_TTA_Template_DS_V52/HANcoder STM32 Target - E407-STM32 algorithm/TTA CAN System/TTA System/Matrix Cycle Manager/Controller Matrix Cycle/controller basic cycle 1/COMP Task - Rx_PotValues1_check/Process_Messages" /begin SUB_GROUP S565_Desync_calculation /end SUB_GROUP /end GROUP
/begin GROUP S467_Process_Messages "HANcoder_E407_TTA_Template_DS_V52/HANcoder STM32 Target - E407-STM32 algorithm/TTA CAN System/TTA System/Matrix Cycle Manager/Controller Matrix Cycle/controller basic cycle 1/COMP Task - Rx_PotValues2_check/Process_Messages" /begin SUB_GROUP S596_Desync_calculation /end SUB_GROUP /end GROUP
/begin GROUP S468_Process_Messages "HANcoder_E407_TTA_Template_DS_V52/HANcoder STM32 Target - E407-STM32 algorithm/TTA CAN System/TTA System/Matrix Cycle Manager/Controller Matrix Cycle/controller basic cycle 1/COMP Task - Rx_PotValues3_check/Process_Messages" /begin SUB_GROUP S626_Desync_calculation /end SUB_GROUP /end GROUP
/begin GROUP S469_Process_Messages "HANcoder_E407_TTA_Template_DS_V52/HANcoder STM32 Target - E407-STM32 algorithm/TTA CAN System/TTA System/Matrix Cycle Manager/Controller Matrix Cycle/controller basic cycle 1/COMP Task - Sync bc1 check/Process_Messages" /begin SUB_GROUP S656_Desync_calculation /end SUB_GROUP /end GROUP
/begin GROUP S688_Transmission_subtasks "HANcoder_E407_TTA_Template_DS_V52/HANcoder STM32 Target - E407-STM32 algorithm/TTA CAN System/TTA System/Matrix Cycle Manager/Controller Matrix Cycle/controller basic cycle 2/COMM Task - Articualtion angle trailer 1/Transmission subtasks"
 /begin SUB_GROUP S699_Check_msg_transmission_CAN1 S699_Check_msg_transmission_CAN2 S699_Msg_Value_Data_Encoded /end SUB_GROUP
/end GROUP
/begin GROUP S689_Transmission_subtasks "HANcoder_E407_TTA_Template_DS_V52/HANcoder STM32 Target - E407-STM32 algorithm/TTA CAN System/TTA System/Matrix Cycle Manager/Controller Matrix Cycle/controller basic cycle 2/COMM Task - Articualtion angle trailer 2/Transmission subtasks"
 /begin SUB_GROUP S717_Check_msg_transmission_CAN1 S717_Check_msg_transmission_CAN2 S717_Msg_Value_Data_Encoded /end SUB_GROUP
/end GROUP
/begin GROUP S690_Transmission_subtasks1 "HANcoder_E407_TTA_Template_DS_V52/HANcoder STM32 Target - E407-STM32 algorithm/TTA CAN System/TTA System/Matrix Cycle Manager/Controller Matrix Cycle/controller basic cycle 2/COMM Task - Sync bc 1/Transmission subtasks1"
 /begin SUB_GROUP S735_Check_msg_transmission_CAN1 S735_Check_msg_transmission_CAN2 /end SUB_GROUP
/end GROUP
/begin GROUP S691_Enabled_Subsystem "HANcoder_E407_TTA_Template_DS_V52/HANcoder STM32 Target - E407-STM32 algorithm/TTA CAN System/TTA System/Matrix Cycle Manager/Controller Matrix Cycle/controller basic cycle 2/COMP Task - Inverse Kinematics Model/Enabled Subsystem"
 /begin REF_MEASUREMENT ArtAngle1_s ArtAngle2_s Delta_I2K_s Member1_ID_s Steering_Input_s Trailer_Amount_s /end REF_MEASUREMENT
/end GROUP
/begin GROUP S693_Process_Messages "HANcoder_E407_TTA_Template_DS_V52/HANcoder STM32 Target - E407-STM32 algorithm/TTA CAN System/TTA System/Matrix Cycle Manager/Controller Matrix Cycle/controller basic cycle 2/COMP Task - Rx_PotValues2_check/Process_Messages" /begin SUB_GROUP S766_Bit_Concat S766_Desync_calculation /end SUB_GROUP /end GROUP
/begin GROUP S694_Process_Messages "HANcoder_E407_TTA_Template_DS_V52/HANcoder STM32 Target - E407-STM32 algorithm/TTA CAN System/TTA System/Matrix Cycle Manager/Controller Matrix Cycle/controller basic cycle 2/COMP Task - Rx_Trailer1Articulation_check/Process_Messages"
 /begin SUB_GROUP S785_Bit_Concat S785_Demux_message_CAN1_and_check_coherence S785_Demux_message_CAN1_and_check_coherence1 S785_Desync_calculation /end SUB_GROUP
 /begin REF_MEASUREMENT new_msg_RX_bc2_Art1 /end REF_MEASUREMENT
/end GROUP
/begin GROUP S696_Process_Messages "HANcoder_E407_TTA_Template_DS_V52/HANcoder STM32 Target - E407-STM32 algorithm/TTA CAN System/TTA System/Matrix Cycle Manager/Controller Matrix Cycle/controller basic cycle 2/COMP Task - Sync bc1 check/Process_Messages" /begin SUB_GROUP S804_Desync_calculation /end SUB_GROUP /end GROUP
/begin GROUP S256_Check_msg_transmission_CAN1 "HANcoder_E407_TTA_Template_DS_V52/HANcoder STM32 Target - E407-STM32 algorithm/TTA CAN System/TTA System/Matrix Cycle Manager/Controller Matrix Cycle/controller basic cycle 0/COMM Task - Sync bc 0/Transmission subtasks/Check msg transmission CAN1" /begin REF_CHARACTERISTIC COMM_Phase1 COMM_Phase_init1 /end REF_CHARACTERISTIC /end GROUP
/begin GROUP S256_Check_msg_transmission_CAN2 "HANcoder_E407_TTA_Template_DS_V52/HANcoder STM32 Target - E407-STM32 algorithm/TTA CAN System/TTA System/Matrix Cycle Manager/Controller Matrix Cycle/controller basic cycle 0/COMM Task - Sync bc 0/Transmission subtasks/Check msg transmission CAN2" /begin REF_CHARACTERISTIC COMM_Phase2 COMM_Phase_init2 /end REF_CHARACTERISTIC /end GROUP
/begin GROUP S274_Check_msg_transmission_CAN1 "HANcoder_E407_TTA_Template_DS_V52/HANcoder STM32 Target - E407-STM32 algorithm/TTA CAN System/TTA System/Matrix Cycle Manager/Controller Matrix Cycle/controller basic cycle 0/COMM Task - Vote1/Transmission subtasks/Check msg transmission CAN1" /begin REF_CHARACTERISTIC COMM_Phase1 COMM_Phase_init1 /end REF_CHARACTERISTIC /end GROUP
/begin GROUP S274_Check_msg_transmission_CAN2 "HANcoder_E407_TTA_Template_DS_V52/HANcoder STM32 Target - E407-STM32 algorithm/TTA CAN System/TTA System/Matrix Cycle Manager/Controller Matrix Cycle/controller basic cycle 0/COMM Task - Vote1/Transmission subtasks/Check msg transmission CAN2" /begin REF_CHARACTERISTIC COMM_Phase2 COMM_Phase_init2 /end REF_CHARACTERISTIC /end GROUP
/begin GROUP S292_Check_msg_transmission_CAN1 "HANcoder_E407_TTA_Template_DS_V52/HANcoder STM32 Target - E407-STM32 algorithm/TTA CAN System/TTA System/Matrix Cycle Manager/Controller Matrix Cycle/controller basic cycle 0/COMM Task - Vote2/Transmission subtasks/Check msg transmission CAN1" /begin REF_CHARACTERISTIC COMM_Phase1 COMM_Phase_init1 /end REF_CHARACTERISTIC /end GROUP
/begin GROUP S292_Check_msg_transmission_CAN2 "HANcoder_E407_TTA_Template_DS_V52/HANcoder STM32 Target - E407-STM32 algorithm/TTA CAN System/TTA System/Matrix Cycle Manager/Controller Matrix Cycle/controller basic cycle 0/COMM Task - Vote2/Transmission subtasks/Check msg transmission CAN2" /begin REF_CHARACTERISTIC COMM_Phase2 COMM_Phase_init2 /end REF_CHARACTERISTIC /end GROUP
/begin GROUP S310_Check_msg_transmission_CAN1 "HANcoder_E407_TTA_Template_DS_V52/HANcoder STM32 Target - E407-STM32 algorithm/TTA CAN System/TTA System/Matrix Cycle Manager/Controller Matrix Cycle/controller basic cycle 0/COMM Task - Vote3/Transmission subtasks/Check msg transmission CAN1" /begin REF_CHARACTERISTIC COMM_Phase1 COMM_Phase_init1 /end REF_CHARACTERISTIC /end GROUP
/begin GROUP S310_Check_msg_transmission_CAN2 "HANcoder_E407_TTA_Template_DS_V52/HANcoder STM32 Target - E407-STM32 algorithm/TTA CAN System/TTA System/Matrix Cycle Manager/Controller Matrix Cycle/controller basic cycle 0/COMM Task - Vote3/Transmission subtasks/Check msg transmission CAN2" /begin REF_CHARACTERISTIC COMM_Phase2 COMM_Phase_init2 /end REF_CHARACTERISTIC /end GROUP
/begin GROUP S327_Timeout_Counter_1_DEBUG "HANcoder_E407_TTA_Template_DS_V52/HANcoder STM32 Target - E407-STM32 algorithm/TTA CAN System/TTA System/Matrix Cycle Manager/Controller Matrix Cycle/controller basic cycle 0/COMP Task - Check Timeouts/Timeout and Board error counter/Timeout Counter 1 DEBUG" /begin REF_MEASUREMENT TM1_timeout_counter_s /end REF_MEASUREMENT /end GROUP
/begin GROUP S327_Timeout_Counter_2_DEBUG "HANcoder_E407_TTA_Template_DS_V52/HANcoder STM32 Target - E407-STM32 algorithm/TTA CAN System/TTA System/Matrix Cycle Manager/Controller Matrix Cycle/controller basic cycle 0/COMP Task - Check Timeouts/Timeout and Board error counter/Timeout Counter 2 DEBUG" /begin REF_MEASUREMENT TM2_timeout_counter_s /end REF_MEASUREMENT /end GROUP
/begin GROUP S327_Timeout_Counter_3_DEBUG "HANcoder_E407_TTA_Template_DS_V52/HANcoder STM32 Target - E407-STM32 algorithm/TTA CAN System/TTA System/Matrix Cycle Manager/Controller Matrix Cycle/controller basic cycle 0/COMP Task - Check Timeouts/Timeout and Board error counter/Timeout Counter 3 DEBUG" /begin REF_MEASUREMENT TM3_timeout_counter_s /end REF_MEASUREMENT /end GROUP
/begin GROUP S336_Desync_calculation "HANcoder_E407_TTA_Template_DS_V52/HANcoder STM32 Target - E407-STM32 algorithm/TTA CAN System/TTA System/Matrix Cycle Manager/Controller Matrix Cycle/controller basic cycle 0/COMP Task - Sync bc0 check/Process_Messages/Desync calculation" /begin REF_CHARACTERISTIC COMM_Phase1 COMM_Phase2 /end REF_CHARACTERISTIC /begin REF_MEASUREMENT Desync_Sync_bc0_s /end REF_MEASUREMENT /end GROUP
/begin GROUP S472_Check_msg_transmission_CAN1 "HANcoder_E407_TTA_Template_DS_V52/HANcoder STM32 Target - E407-STM32 algorithm/TTA CAN System/TTA System/Matrix Cycle Manager/Controller Matrix Cycle/controller basic cycle 1/COMM Task - PotValue trailer 1/Transmission subtasks/Check msg transmission CAN1" /begin REF_CHARACTERISTIC COMM_Phase1 COMM_Phase_init1 /end REF_CHARACTERISTIC /end GROUP
/begin GROUP S472_Check_msg_transmission_CAN2 "HANcoder_E407_TTA_Template_DS_V52/HANcoder STM32 Target - E407-STM32 algorithm/TTA CAN System/TTA System/Matrix Cycle Manager/Controller Matrix Cycle/controller basic cycle 1/COMM Task - PotValue trailer 1/Transmission subtasks/Check msg transmission CAN2" /begin REF_CHARACTERISTIC COMM_Phase2 COMM_Phase_init2 /end REF_CHARACTERISTIC /end GROUP
/begin GROUP S472_Msg_Value_Data_Encoded "HANcoder_E407_TTA_Template_DS_V52/HANcoder STM32 Target - E407-STM32 algorithm/TTA CAN System/TTA System/Matrix Cycle Manager/Controller Matrix Cycle/controller basic cycle 1/COMM Task - PotValue trailer 1/Transmission subtasks/Msg_Value_Data_Encoded" /begin REF_MEASUREMENT PotValue1_s /end REF_MEASUREMENT /end GROUP
/begin GROUP S492_Check_msg_transmission_CAN1 "HANcoder_E407_TTA_Template_DS_V52/HANcoder STM32 Target - E407-STM32 algorithm/TTA CAN System/TTA System/Matrix Cycle Manager/Controller Matrix Cycle/controller basic cycle 1/COMM Task - PotValue trailer 2/Transmission subtasks/Check msg transmission CAN1" /begin REF_CHARACTERISTIC COMM_Phase1 COMM_Phase_init1 /end REF_CHARACTERISTIC /end GROUP
/begin GROUP S492_Check_msg_transmission_CAN2 "HANcoder_E407_TTA_Template_DS_V52/HANcoder STM32 Target - E407-STM32 algorithm/TTA CAN System/TTA System/Matrix Cycle Manager/Controller Matrix Cycle/controller basic cycle 1/COMM Task - PotValue trailer 2/Transmission subtasks/Check msg transmission CAN2" /begin REF_CHARACTERISTIC COMM_Phase2 COMM_Phase_init2 /end REF_CHARACTERISTIC /end GROUP
/begin GROUP S492_Msg_Value_Data_Encoded "HANcoder_E407_TTA_Template_DS_V52/HANcoder STM32 Target - E407-STM32 algorithm/TTA CAN System/TTA System/Matrix Cycle Manager/Controller Matrix Cycle/controller basic cycle 1/COMM Task - PotValue trailer 2/Transmission subtasks/Msg_Value_Data_Encoded" /begin REF_MEASUREMENT PotValue2_s /end REF_MEASUREMENT /end GROUP
/begin GROUP S512_Check_msg_transmission_CAN1 "HANcoder_E407_TTA_Template_DS_V52/HANcoder STM32 Target - E407-STM32 algorithm/TTA CAN System/TTA System/Matrix Cycle Manager/Controller Matrix Cycle/controller basic cycle 1/COMM Task - PotValue trailer 3/Transmission subtasks/Check msg transmission CAN1" /begin REF_CHARACTERISTIC COMM_Phase1 COMM_Phase_init1 /end REF_CHARACTERISTIC /end GROUP
/begin GROUP S512_Check_msg_transmission_CAN2 "HANcoder_E407_TTA_Template_DS_V52/HANcoder STM32 Target - E407-STM32 algorithm/TTA CAN System/TTA System/Matrix Cycle Manager/Controller Matrix Cycle/controller basic cycle 1/COMM Task - PotValue trailer 3/Transmission subtasks/Check msg transmission CAN2" /begin REF_CHARACTERISTIC COMM_Phase2 COMM_Phase_init2 /end REF_CHARACTERISTIC /end GROUP
/begin GROUP S512_Msg_Value_Data_Encoded "HANcoder_E407_TTA_Template_DS_V52/HANcoder STM32 Target - E407-STM32 algorithm/TTA CAN System/TTA System/Matrix Cycle Manager/Controller Matrix Cycle/controller basic cycle 1/COMM Task - PotValue trailer 3/Transmission subtasks/Msg_Value_Data_Encoded" /begin REF_MEASUREMENT PotValue3_s /end REF_MEASUREMENT /end GROUP
/begin GROUP S532_Check_msg_transmission_CAN1 "HANcoder_E407_TTA_Template_DS_V52/HANcoder STM32 Target - E407-STM32 algorithm/TTA CAN System/TTA System/Matrix Cycle Manager/Controller Matrix Cycle/controller basic cycle 1/COMM Task - Sync bc 1/Transmission subtasks1/Check msg transmission CAN1" /begin REF_CHARACTERISTIC COMM_Phase1 COMM_Phase_init1 /end REF_CHARACTERISTIC /end GROUP
/begin GROUP S532_Check_msg_transmission_CAN2 "HANcoder_E407_TTA_Template_DS_V52/HANcoder STM32 Target - E407-STM32 algorithm/TTA CAN System/TTA System/Matrix Cycle Manager/Controller Matrix Cycle/controller basic cycle 1/COMM Task - Sync bc 1/Transmission subtasks1/Check msg transmission CAN2" /begin REF_CHARACTERISTIC COMM_Phase2 COMM_Phase_init2 /end REF_CHARACTERISTIC /end GROUP
/begin GROUP S565_Desync_calculation "HANcoder_E407_TTA_Template_DS_V52/HANcoder STM32 Target - E407-STM32 algorithm/TTA CAN System/TTA System/Matrix Cycle Manager/Controller Matrix Cycle/controller basic cycle 1/COMP Task - Rx_PotValues1_check/Process_Messages/Desync calculation" /begin REF_CHARACTERISTIC COMM_Phase1 COMM_Phase2 /end REF_CHARACTERISTIC /begin REF_MEASUREMENT Desync_Sync_bc1_vem_s /end REF_MEASUREMENT /end GROUP
/begin GROUP S596_Desync_calculation "HANcoder_E407_TTA_Template_DS_V52/HANcoder STM32 Target - E407-STM32 algorithm/TTA CAN System/TTA System/Matrix Cycle Manager/Controller Matrix Cycle/controller basic cycle 1/COMP Task - Rx_PotValues2_check/Process_Messages/Desync calculation" /begin REF_CHARACTERISTIC COMM_Phase1 COMM_Phase2 /end REF_CHARACTERISTIC /end GROUP
/begin GROUP S626_Desync_calculation "HANcoder_E407_TTA_Template_DS_V52/HANcoder STM32 Target - E407-STM32 algorithm/TTA CAN System/TTA System/Matrix Cycle Manager/Controller Matrix Cycle/controller basic cycle 1/COMP Task - Rx_PotValues3_check/Process_Messages/Desync calculation" /begin REF_CHARACTERISTIC COMM_Phase1 COMM_Phase2 /end REF_CHARACTERISTIC /end GROUP
/begin GROUP S656_Desync_calculation "HANcoder_E407_TTA_Template_DS_V52/HANcoder STM32 Target - E407-STM32 algorithm/TTA CAN System/TTA System/Matrix Cycle Manager/Controller Matrix Cycle/controller basic cycle 1/COMP Task - Sync bc1 check/Process_Messages/Desync calculation" /begin REF_CHARACTERISTIC COMM_Phase1 COMM_Phase2 /end REF_CHARACTERISTIC /begin REF_MEASUREMENT Desync_Sync_bc1_s /end REF_MEASUREMENT /end GROUP
/begin GROUP S699_Check_msg_transmission_CAN1 "HANcoder_E407_TTA_Template_DS_V52/HANcoder STM32 Target - E407-STM32 algorithm/TTA CAN System/TTA System/Matrix Cycle Manager/Controller Matrix Cycle/controller basic cycle 2/COMM Task - Articualtion angle trailer 1/Transmission subtasks/Check msg transmission CAN1" /begin REF_CHARACTERISTIC COMM_Phase1 COMM_Phase_init1 /end REF_CHARACTERISTIC /end GROUP
/begin GROUP S699_Check_msg_transmission_CAN2 "HANcoder_E407_TTA_Template_DS_V52/HANcoder STM32 Target - E407-STM32 algorithm/TTA CAN System/TTA System/Matrix Cycle Manager/Controller Matrix Cycle/controller basic cycle 2/COMM Task - Articualtion angle trailer 1/Transmission subtasks/Check msg transmission CAN2" /begin REF_CHARACTERISTIC COMM_Phase2 COMM_Phase_init2 /end REF_CHARACTERISTIC /end GROUP
/begin GROUP S699_Msg_Value_Data_Encoded "HANcoder_E407_TTA_Template_DS_V52/HANcoder STM32 Target - E407-STM32 algorithm/TTA CAN System/TTA System/Matrix Cycle Manager/Controller Matrix Cycle/controller basic cycle 2/COMM Task - Articualtion angle trailer 1/Transmission subtasks/Msg_Value_Data_Encoded" /begin REF_MEASUREMENT Trailer1_Articulation_s /end REF_MEASUREMENT /end GROUP
/begin GROUP S717_Check_msg_transmission_CAN1 "HANcoder_E407_TTA_Template_DS_V52/HANcoder STM32 Target - E407-STM32 algorithm/TTA CAN System/TTA System/Matrix Cycle Manager/Controller Matrix Cycle/controller basic cycle 2/COMM Task - Articualtion angle trailer 2/Transmission subtasks/Check msg transmission CAN1" /begin REF_CHARACTERISTIC COMM_Phase1 COMM_Phase_init1 /end REF_CHARACTERISTIC /end GROUP
/begin GROUP S717_Check_msg_transmission_CAN2 "HANcoder_E407_TTA_Template_DS_V52/HANcoder STM32 Target - E407-STM32 algorithm/TTA CAN System/TTA System/Matrix Cycle Manager/Controller Matrix Cycle/controller basic cycle 2/COMM Task - Articualtion angle trailer 2/Transmission subtasks/Check msg transmission CAN2" /begin REF_CHARACTERISTIC COMM_Phase2 COMM_Phase_init2 /end REF_CHARACTERISTIC /end GROUP
/begin GROUP S717_Msg_Value_Data_Encoded "HANcoder_E407_TTA_Template_DS_V52/HANcoder STM32 Target - E407-STM32 algorithm/TTA CAN System/TTA System/Matrix Cycle Manager/Controller Matrix Cycle/controller basic cycle 2/COMM Task - Articualtion angle trailer 2/Transmission subtasks/Msg_Value_Data_Encoded" /begin REF_MEASUREMENT Trailer2_Articulation_s /end REF_MEASUREMENT /end GROUP
/begin GROUP S735_Check_msg_transmission_CAN1 "HANcoder_E407_TTA_Template_DS_V52/HANcoder STM32 Target - E407-STM32 algorithm/TTA CAN System/TTA System/Matrix Cycle Manager/Controller Matrix Cycle/controller basic cycle 2/COMM Task - Sync bc 1/Transmission subtasks1/Check msg transmission CAN1" /begin REF_CHARACTERISTIC COMM_Phase1 COMM_Phase_init1 /end REF_CHARACTERISTIC /end GROUP
/begin GROUP S735_Check_msg_transmission_CAN2 "HANcoder_E407_TTA_Template_DS_V52/HANcoder STM32 Target - E407-STM32 algorithm/TTA CAN System/TTA System/Matrix Cycle Manager/Controller Matrix Cycle/controller basic cycle 2/COMM Task - Sync bc 1/Transmission subtasks1/Check msg transmission CAN2" /begin REF_CHARACTERISTIC COMM_Phase2 COMM_Phase_init2 /end REF_CHARACTERISTIC /end GROUP
/begin GROUP S766_Bit_Concat "HANcoder_E407_TTA_Template_DS_V52/HANcoder STM32 Target - E407-STM32 algorithm/TTA CAN System/TTA System/Matrix Cycle Manager/Controller Matrix Cycle/controller basic cycle 2/COMP Task - Rx_PotValues2_check/Process_Messages/Bit Concat" /begin REF_MEASUREMENT Trailer2Articulation_RX_s /end REF_MEASUREMENT /end GROUP
/begin GROUP S766_Desync_calculation "HANcoder_E407_TTA_Template_DS_V52/HANcoder STM32 Target - E407-STM32 algorithm/TTA CAN System/TTA System/Matrix Cycle Manager/Controller Matrix Cycle/controller basic cycle 2/COMP Task - Rx_PotValues2_check/Process_Messages/Desync calculation" /begin REF_CHARACTERISTIC COMM_Phase1 COMM_Phase2 /end REF_CHARACTERISTIC /end GROUP
/begin GROUP S785_Bit_Concat "HANcoder_E407_TTA_Template_DS_V52/HANcoder STM32 Target - E407-STM32 algorithm/TTA CAN System/TTA System/Matrix Cycle Manager/Controller Matrix Cycle/controller basic cycle 2/COMP Task - Rx_Trailer1Articulation_check/Process_Messages/Bit Concat" /begin REF_MEASUREMENT Trailer1Articulation_RX_s /end REF_MEASUREMENT /end GROUP
/begin GROUP S785_Demux_message_CAN1_and_check_coherence "HANcoder_E407_TTA_Template_DS_V52/HANcoder STM32 Target - E407-STM32 algorithm/TTA CAN System/TTA System/Matrix Cycle Manager/Controller Matrix Cycle/controller basic cycle 2/COMP Task - Rx_Trailer1Articulation_check/Process_Messages/Demux message CAN1 and check coherence" /begin SUB_GROUP S788_Subsystem /end SUB_GROUP /end GROUP
/begin GROUP S785_Demux_message_CAN1_and_check_coherence1 "HANcoder_E407_TTA_Template_DS_V52/HANcoder STM32 Target - E407-STM32 algorithm/TTA CAN System/TTA System/Matrix Cycle Manager/Controller Matrix Cycle/controller basic cycle 2/COMP Task - Rx_Trailer1Articulation_check/Process_Messages/Demux message CAN1 and check coherence1" /begin SUB_GROUP S789_Subsystem /end SUB_GROUP /end GROUP
/begin GROUP S785_Desync_calculation "HANcoder_E407_TTA_Template_DS_V52/HANcoder STM32 Target - E407-STM32 algorithm/TTA CAN System/TTA System/Matrix Cycle Manager/Controller Matrix Cycle/controller basic cycle 2/COMP Task - Rx_Trailer1Articulation_check/Process_Messages/Desync calculation" /begin REF_CHARACTERISTIC COMM_Phase1 COMM_Phase2 /end REF_CHARACTERISTIC /begin REF_MEASUREMENT Desync_Sync_bc2_vem_s /end REF_MEASUREMENT /end GROUP
/begin GROUP S804_Desync_calculation "HANcoder_E407_TTA_Template_DS_V52/HANcoder STM32 Target - E407-STM32 algorithm/TTA CAN System/TTA System/Matrix Cycle Manager/Controller Matrix Cycle/controller basic cycle 2/COMP Task - Sync bc1 check/Process_Messages/Desync calculation" /begin REF_CHARACTERISTIC COMM_Phase1 COMM_Phase2 /end REF_CHARACTERISTIC /end GROUP
/begin GROUP S788_Subsystem "HANcoder_E407_TTA_Template_DS_V52/HANcoder STM32 Target - E407-STM32 algorithm/TTA CAN System/TTA System/Matrix Cycle Manager/Controller Matrix Cycle/controller basic cycle 2/COMP Task - Rx_Trailer1Articulation_check/Process_Messages/Demux message CAN1 and check coherence/Subsystem" /begin REF_MEASUREMENT basic_cycle_RX_Art1_CAN1 /end REF_MEASUREMENT /end GROUP
/begin GROUP S789_Subsystem "HANcoder_E407_TTA_Template_DS_V52/HANcoder STM32 Target - E407-STM32 algorithm/TTA CAN System/TTA System/Matrix Cycle Manager/Controller Matrix Cycle/controller basic cycle 2/COMP Task - Rx_Trailer1Articulation_check/Process_Messages/Demux message CAN1 and check coherence1/Subsystem" /begin REF_MEASUREMENT basic_cycle_RX_Art1_CAN2 /end REF_MEASUREMENT /end GROUP
/end MODULE
/end PROJECT
/* (add any file trailer comments here) */
/* EOF HANcoder_E407_TTA_Template_DS_V52.a2l */
