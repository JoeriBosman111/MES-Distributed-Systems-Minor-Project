/******************************************************************************
* ASAP2 file: HANcoder_Olimexino.a2l
* Academic License - for use in teaching, academic research, and meeting
* course requirements at degree granting institutions only. Not for
* government, commercial, or other organizational use.
* Code generation for model "HANcoder_Olimexino".
* Model version : 16.0
* Simulink Coder version : 9.7 (R2022a) 13-Nov-2021
* C source code generated on : Wed Oct 19 20:24:39 2022
* Target selection: ert.tlc
* Embedded hardware selection: ARM Compatible->ARM Cortex
* Code generation objectives: Unspecified
* Validation result: Not run
* (add additional file header information here)
******************************************************************************/ ASAP2_VERSION 1 31
/* Version 1.31 */
/begin PROJECT ProjectName "HANcoder_Olimexino_softwareID_v1_191022_202436"
/begin HEADER "Header Comments go here" /end HEADER
/begin MODULE ModuleName "Module Comment Goes Here"
/begin MOD_PAR "MOD PAR Comment Goes Here" ADDR_EPK 0x0801e008 CPU_TYPE "STM32F103" ECU "Olimexino" EPK "HANcoder_Olimexino_softwareID_v1_191022_202436"
 SYSTEM_CONSTANT "XcpStationID string length" "0x0000002e"
 SYSTEM_CONSTANT "RAM-FlashOffset" "-402605264" /end MOD_PAR
/begin MOD_COMMON "Mod Common Comment Here" BYTE_ORDER MSB_LAST /end MOD_COMMON
/begin RECORD_LAYOUT Scalar_BOOLEAN FNC_VALUES 1 UBYTE COLUMN_DIR DIRECT /end RECORD_LAYOUT
/begin RECORD_LAYOUT Scalar_UBYTE FNC_VALUES 1 UBYTE COLUMN_DIR DIRECT /end RECORD_LAYOUT
/begin RECORD_LAYOUT Scalar_BYTE FNC_VALUES 1 SBYTE COLUMN_DIR DIRECT /end RECORD_LAYOUT
/begin RECORD_LAYOUT Scalar_UWORD FNC_VALUES 1 UWORD COLUMN_DIR DIRECT /end RECORD_LAYOUT
/begin RECORD_LAYOUT Scalar_SWORD FNC_VALUES 1 SWORD COLUMN_DIR DIRECT /end RECORD_LAYOUT
/begin RECORD_LAYOUT Scalar_ULONG FNC_VALUES 1 ULONG COLUMN_DIR DIRECT /end RECORD_LAYOUT
/begin RECORD_LAYOUT Scalar_LONG FNC_VALUES 1 SLONG COLUMN_DIR DIRECT /end RECORD_LAYOUT
/begin RECORD_LAYOUT Scalar_FLOAT32_IEEE FNC_VALUES 1 FLOAT32_IEEE COLUMN_DIR DIRECT /end RECORD_LAYOUT
/begin RECORD_LAYOUT Scalar_FLOAT64_IEEE FNC_VALUES 1 FLOAT64_IEEE COLUMN_DIR DIRECT /end RECORD_LAYOUT
/begin RECORD_LAYOUT Lookup1D_BYTE FNC_VALUES 1 SBYTE COLUMN_DIR DIRECT /end RECORD_LAYOUT
/begin RECORD_LAYOUT Lookup1D_X_BYTE AXIS_PTS_X 1 SBYTE INDEX_INCR DIRECT /end RECORD_LAYOUT
/begin RECORD_LAYOUT Lookup1D_UBYTE FNC_VALUES 1 UBYTE COLUMN_DIR DIRECT /end RECORD_LAYOUT
/begin RECORD_LAYOUT Lookup1D_X_UBYTE AXIS_PTS_X 1 UBYTE INDEX_INCR DIRECT /end RECORD_LAYOUT
/begin RECORD_LAYOUT Lookup1D_UWORD FNC_VALUES 1 UWORD COLUMN_DIR DIRECT /end RECORD_LAYOUT
/begin RECORD_LAYOUT Lookup1D_X_UWORD AXIS_PTS_X 1 UWORD INDEX_INCR DIRECT /end RECORD_LAYOUT
/begin RECORD_LAYOUT Lookup1D_WORD FNC_VALUES 1 SWORD COLUMN_DIR DIRECT /end RECORD_LAYOUT
/begin RECORD_LAYOUT Lookup1D_X_WORD AXIS_PTS_X 1 SWORD INDEX_INCR DIRECT /end RECORD_LAYOUT
/begin RECORD_LAYOUT Lookup1D_ULONG FNC_VALUES 1 ULONG COLUMN_DIR DIRECT /end RECORD_LAYOUT
/begin RECORD_LAYOUT Lookup1D_X_ULONG AXIS_PTS_X 1 ULONG INDEX_INCR DIRECT /end RECORD_LAYOUT
/begin RECORD_LAYOUT Lookup1D_SLONG FNC_VALUES 1 SLONG COLUMN_DIR DIRECT /end RECORD_LAYOUT
/begin RECORD_LAYOUT Lookup1D_X_LONG AXIS_PTS_X 1 SLONG INDEX_INCR DIRECT /end RECORD_LAYOUT
/begin RECORD_LAYOUT Lookup1D_FLOAT32_IEEE FNC_VALUES 1 FLOAT32_IEEE COLUMN_DIR DIRECT /end RECORD_LAYOUT
/begin RECORD_LAYOUT Lookup1D_X_FLOAT32_IEEE AXIS_PTS_X 1 FLOAT32_IEEE INDEX_INCR DIRECT /end RECORD_LAYOUT
/begin RECORD_LAYOUT Lookup1D_FLOAT64_IEEE FNC_VALUES 1 FLOAT64_IEEE COLUMN_DIR DIRECT /end RECORD_LAYOUT
/begin RECORD_LAYOUT Lookup1D_X_FLOAT64_IEEE AXIS_PTS_X 1 FLOAT64_IEEE INDEX_INCR DIRECT /end RECORD_LAYOUT
/begin RECORD_LAYOUT Lookup2D_UBYTE FNC_VALUES 1 UBYTE COLUMN_DIR DIRECT /end RECORD_LAYOUT
/begin RECORD_LAYOUT Lookup2D_X_UBYTE AXIS_PTS_X 1 UBYTE INDEX_INCR DIRECT /end RECORD_LAYOUT
/begin RECORD_LAYOUT Lookup2D_BYTE FNC_VALUES 1 SBYTE COLUMN_DIR DIRECT /end RECORD_LAYOUT
/begin RECORD_LAYOUT Lookup2D_X_BYTE AXIS_PTS_X 1 SBYTE INDEX_INCR DIRECT /end RECORD_LAYOUT
/begin RECORD_LAYOUT Lookup2D_UWORD FNC_VALUES 1 UWORD COLUMN_DIR DIRECT /end RECORD_LAYOUT
/begin RECORD_LAYOUT Lookup2D_X_UWORD AXIS_PTS_X 1 UWORD INDEX_INCR DIRECT /end RECORD_LAYOUT
/begin RECORD_LAYOUT Lookup2D_WORD FNC_VALUES 1 SWORD COLUMN_DIR DIRECT /end RECORD_LAYOUT
/begin RECORD_LAYOUT Lookup2D_X_WORD AXIS_PTS_X 1 SWORD INDEX_INCR DIRECT /end RECORD_LAYOUT
/begin RECORD_LAYOUT Lookup2D_ULONG FNC_VALUES 1 ULONG COLUMN_DIR DIRECT /end RECORD_LAYOUT
/begin RECORD_LAYOUT Lookup2D_X_ULONG AXIS_PTS_X 1 ULONG INDEX_INCR DIRECT /end RECORD_LAYOUT
/begin RECORD_LAYOUT Lookup2D_LONG FNC_VALUES 1 SLONG COLUMN_DIR DIRECT /end RECORD_LAYOUT
/begin RECORD_LAYOUT Lookup2D_X_LONG AXIS_PTS_X 1 SLONG INDEX_INCR DIRECT /end RECORD_LAYOUT
/begin RECORD_LAYOUT Lookup2D_FLOAT32_IEEE FNC_VALUES 1 FLOAT32_IEEE COLUMN_DIR DIRECT /end RECORD_LAYOUT
/begin RECORD_LAYOUT Lookup2D_X_FLOAT32_IEEE AXIS_PTS_X 1 FLOAT32_IEEE INDEX_INCR DIRECT /end RECORD_LAYOUT
/begin RECORD_LAYOUT Lookup2D_FLOAT64_IEEE FNC_VALUES 1 FLOAT64_IEEE COLUMN_DIR DIRECT /end RECORD_LAYOUT
/begin RECORD_LAYOUT Lookup2D_X_FLOAT64_IEEE AXIS_PTS_X 1 FLOAT64_IEEE INDEX_INCR DIRECT /end RECORD_LAYOUT
/begin CHARACTERISTIC Direction "" VALUE 0x20000008 Scalar_FLOAT64_IEEE 0 HANcoder_Olimexino_CM_double -1.7E+308 1.7E+308 /end CHARACTERISTIC
/begin CHARACTERISTIC actioni "" VALUE 0x20000018 Scalar_FLOAT64_IEEE 0 HANcoder_Olimexino_CM_double -1.7E+308 1.7E+308 /end CHARACTERISTIC
/begin CHARACTERISTIC actionp "" VALUE 0x20000020 Scalar_FLOAT64_IEEE 0 HANcoder_Olimexino_CM_double -1.7E+308 1.7E+308 /end CHARACTERISTIC
/begin CHARACTERISTIC HANtuneOverride "" VALUE 0x20000010 Scalar_BOOLEAN 0 HANcoder_Olimexino_CM_boolean 0 1 /end CHARACTERISTIC
/begin MEASUREMENT motor_rpm "" FLOAT64_IEEE HANcoder_Olimexino_CM_double 0 0 -1.7E+308 1.7E+308 ECU_ADDRESS 0x20000620 /end MEASUREMENT
/begin MEASUREMENT Error "" FLOAT64_IEEE HANcoder_Olimexino_CM_double 0 0 -1.7E+308 1.7E+308 ECU_ADDRESS 0x200005f8 /end MEASUREMENT
/begin MEASUREMENT SI_FreeStack "" ULONG HANcoder_Olimexino_CM_uint32 0 0 0 4294967295 ECU_ADDRESS 0x2000060c /end MEASUREMENT
/begin MEASUREMENT SI_FreeHeap "" ULONG HANcoder_Olimexino_CM_uint32 0 0 0 4294967295 ECU_ADDRESS 0x20000608 /end MEASUREMENT
/begin MEASUREMENT speed_demand_per "" ULONG HANcoder_Olimexino_CM_ufix32_En21 0 0 0 2047.9999995231628 ECU_ADDRESS 0x2000064c /end MEASUREMENT
/begin MEASUREMENT pulse_per_second "" SLONG HANcoder_Olimexino_CM_sfix32_S100 0 0 -2.147483648E+11 2.147483647E+11 ECU_ADDRESS 0x20000628 /end MEASUREMENT
/begin MEASUREMENT encoder_output "" SLONG HANcoder_Olimexino_CM_int32 0 0 -2147483648 2147483647 ECU_ADDRESS 0x2000061c /end MEASUREMENT
/begin MEASUREMENT PWM "" UWORD HANcoder_Olimexino_CM_uint16 0 0 0 65535 ECU_ADDRESS 0x20000602 /end MEASUREMENT
/begin MEASUREMENT SI_CPUload "" UBYTE HANcoder_Olimexino_CM_uint8 0 0 0 255 ECU_ADDRESS 0x20000604 /end MEASUREMENT
/begin MEASUREMENT LedValue "" UBYTE HANcoder_Olimexino_CM_boolean 0 0 0 1 ECU_ADDRESS 0x20000600 /end MEASUREMENT
/begin MEASUREMENT direction "" UBYTE HANcoder_Olimexino_CM_boolean 0 0 0 1 ECU_ADDRESS 0x20000618 /end MEASUREMENT
/begin COMPU_METHOD HANcoder_Olimexino_CM_double "Q = V" RAT_FUNC "%15.10" "" COEFFS 0 1 0 0 0 1 /end COMPU_METHOD
/begin COMPU_METHOD HANcoder_Olimexino_CM_boolean "Q = V" RAT_FUNC "%1.0" "" COEFFS 0 1 0 0 0 1 /end COMPU_METHOD
/begin COMPU_METHOD HANcoder_Olimexino_CM_uint32 "Q = V" RAT_FUNC "%10.0" "" COEFFS 0 1 0 0 0 1 /end COMPU_METHOD
/begin COMPU_METHOD HANcoder_Olimexino_CM_ufix32_En21 "Q = V*2097152.000000" RAT_FUNC "%20.16" "" COEFFS 0 2097152.000000 0.000000 0 0 1.000000 /end COMPU_METHOD
/begin COMPU_METHOD HANcoder_Olimexino_CM_sfix32_S100 "Q = V/100.000000" RAT_FUNC "%12.0" "" COEFFS 0 1.000000 0.000000 0 0 100.000000 /end COMPU_METHOD
/begin COMPU_METHOD HANcoder_Olimexino_CM_int32 "Q = V" RAT_FUNC "%10.0" "" COEFFS 0 1 0 0 0 1 /end COMPU_METHOD
/begin COMPU_METHOD HANcoder_Olimexino_CM_uint16 "Q = V" RAT_FUNC "%5.0" "" COEFFS 0 1 0 0 0 1 /end COMPU_METHOD
/begin COMPU_METHOD HANcoder_Olimexino_CM_uint8 "Q = V" RAT_FUNC "%3.0" "" COEFFS 0 1 0 0 0 1 /end COMPU_METHOD
/begin GROUP HANcoder_Olimexino "HANcoder_Olimexino" /* Root */ ROOT /begin SUB_GROUP Root_HANcoder_STM32_Target___Olimexino_STM32_algorithm /end SUB_GROUP /end GROUP
/begin GROUP Root_HANcoder_STM32_Target___Olimexino_STM32_algorithm "HANcoder_Olimexino/HANcoder STM32 Target - Olimexino-STM32 algorithm"
 /begin SUB_GROUP S1_Algorithm S1_Feedback_signal S1_Reference_signal S1_Sytem_information /end SUB_GROUP
 /begin REF_CHARACTERISTIC Direction /end REF_CHARACTERISTIC
 /begin REF_MEASUREMENT Error PWM direction /end REF_MEASUREMENT
/end GROUP
/begin GROUP S1_Algorithm "HANcoder_Olimexino/HANcoder STM32 Target - Olimexino-STM32 algorithm/Algorithm" /begin REF_CHARACTERISTIC HANtuneOverride /end REF_CHARACTERISTIC /begin REF_MEASUREMENT LedValue /end REF_MEASUREMENT /end GROUP
/begin GROUP S1_Feedback_signal "HANcoder_Olimexino/HANcoder STM32 Target - Olimexino-STM32 algorithm/Feedback signal" /begin SUB_GROUP S7_Quadrature_Encoder_Get /end SUB_GROUP /begin REF_MEASUREMENT motor_rpm pulse_per_second /end REF_MEASUREMENT /end GROUP
/begin GROUP S1_Reference_signal "HANcoder_Olimexino/HANcoder STM32 Target - Olimexino-STM32 algorithm/Reference signal" /begin REF_MEASUREMENT speed_demand_per /end REF_MEASUREMENT /end GROUP
/begin GROUP S1_Sytem_information "HANcoder_Olimexino/HANcoder STM32 Target - Olimexino-STM32 algorithm/Sytem information" /begin SUB_GROUP S13_Get_CPU_load S13_Get_free_Heap S13_Get_free_Stack /end SUB_GROUP /end GROUP
/begin GROUP S7_Quadrature_Encoder_Get "HANcoder_Olimexino/HANcoder STM32 Target - Olimexino-STM32 algorithm/Feedback signal/Quadrature Encoder Get" /begin REF_MEASUREMENT encoder_output /end REF_MEASUREMENT /end GROUP
/begin GROUP S13_Get_CPU_load "HANcoder_Olimexino/HANcoder STM32 Target - Olimexino-STM32 algorithm/Sytem information/Get CPU load" /begin REF_MEASUREMENT SI_CPUload /end REF_MEASUREMENT /end GROUP
/begin GROUP S13_Get_free_Heap "HANcoder_Olimexino/HANcoder STM32 Target - Olimexino-STM32 algorithm/Sytem information/Get free Heap" /begin REF_MEASUREMENT SI_FreeStack /end REF_MEASUREMENT /end GROUP
/begin GROUP S13_Get_free_Stack "HANcoder_Olimexino/HANcoder STM32 Target - Olimexino-STM32 algorithm/Sytem information/Get free Stack" /begin REF_MEASUREMENT SI_FreeHeap /end REF_MEASUREMENT /end GROUP
/begin GROUP S25_Internal_Parameters "HANcoder_Olimexino/HANcoder STM32 Target - Olimexino-STM32 algorithm/Discrete PID Controller/I Gain/Internal Parameters" /begin REF_CHARACTERISTIC actioni /end REF_CHARACTERISTIC /end GROUP
/begin GROUP S33_Internal_Parameters "HANcoder_Olimexino/HANcoder STM32 Target - Olimexino-STM32 algorithm/Discrete PID Controller/Parallel P Gain/Internal Parameters" /begin REF_CHARACTERISTIC actionp /end REF_CHARACTERISTIC /end GROUP
/end MODULE
/end PROJECT
/* (add any file trailer comments here) */
/* EOF HANcoder_Olimexino.a2l */
